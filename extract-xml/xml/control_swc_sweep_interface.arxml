AUTOSAR XML (schema 4-2-2)
package /Interfaces
  8 x sender receiver interface:
    J6LCANRxInp
      data J6LCANRxInp: category=STRUCTURE, sw-calibration-access=READ-ONLY, type=J6L_RxBus
    LocalizationInfo
      data LocalizationInfo: category=STRUCTURE, sw-calibration-access=READ-ONLY, type=LocalizationInfo
    PlanningInfo
      data PlanningInfo: category=STRUCTURE, sw-calibration-access=READ-ONLY, type=PlanningInfo
    ADMInfoSOC2MCU
      data ADMInfoSOC2MCU: category=STRUCTURE, sw-calibration-access=READ-ONLY, type=ADMInfoSOC2MCU
    ChassisInp
      data ChassisInp: category=STRUCTURE, sw-calibration-access=READ-ONLY, type=ChassisInfo
    ADMInfoMCU2SOC
      data ADMInfoMCU2SOC: category=STRUCTURE, sw-calibration-access=READ-ONLY, type=ADMInfoMCU2SOC
    CtrlDebugInfoMCU2SOC
      data CtrlDebugInfoMCU2SOC: category=STRUCTURE, sw-calibration-access=READ-ONLY, type=CtrlInfoMCU2SOC
    J6LCANTxOutp
      data J6LCANTxOutp: category=STRUCTURE, sw-calibration-access=READ-ONLY, type=J6L_TxBus
