AUTOSAR XML (schema 4-2-2)
package /Components/SwcImplementations
  swc implementation control_swc_sweep_Impl: programming-language=C, sw-version=1.663.1, used-code-generator=Embedded Coder 7.4 (R2020a) 18-Nov-2019, vendor-id=0, behavior=control_swc_sweep_IB
    code-descriptors:
      code Code
        artifact-descriptors:
          short-label=ComputeLongitudinalErr_0dkiupfc_c, category=SWSRC
          short-label=NormalizeAngle_QLQB2EiZ_c, category=SWSRC
          short-label=PadeApproximantOfDegre_bKEiQENC_c, category=SWSRC
          short-label=control_swc_sweep_c, category=SWSRC
          short-label=control_swc_sweep_data_c, category=SWSRC
          short-label=invNxN_nZSgBrIQ_c, category=SWSRC
          short-label=look1_iflf_binlcapw_c, category=SWSRC
          short-label=look1_iflf_binlxpw_c, category=SWSRC
          short-label=look1_iflf_linlcapw_c, category=SWSRC
          short-label=lusolve_ap6eua7C_c, category=SWSRC
          short-label=rt_hypotf_c, category=SWSRC
          short-label=ComputeLongitudinalErr_0dkiupfc_h, category=SWHDR
          short-label=NormalizeAngle_QLQB2EiZ_h, category=SWHDR
          short-label=PadeApproximantOfDegre_bKEiQENC_h, category=SWHDR
          short-label=control_swc_sweep_h, category=SWHDR
          short-label=control_swc_sweep_private_h, category=SWHDR
          short-label=control_swc_sweep_types_h, category=SWHDR
          short-label=invNxN_nZSgBrIQ_h, category=SWHDR
          short-label=look1_iflf_binlcapw_h, category=SWHDR
          short-label=look1_iflf_binlxpw_h, category=SWHDR
          short-label=look1_iflf_linlcapw_h, category=SWHDR
          short-label=lusolve_ap6eua7C_h, category=SWHDR
          short-label=rt_hypotf_h, category=SWHDR
          short-label=rtwtypes_h, category=SWHDR
    resource consumption RsrcCons_control_swc_sweep
