AUTOSAR XML (schema 4-2-2)
standard types defined: Float, UInt32, Double, SInt32, Boolean, UInt8, SInt8, UInt16, float32, uint32, float64, sint32, boolean, uint8, sint8, uint16
package /DataTypes
  42 x impl type:
    J6L_RxBus: category=STRUCTURE
      361 x element, all with category=TYPE_REFERENCE, implementation-data-type=Float:
        ATR_FM_AntiTheftCmdStat  # This parameter is used to identify the specific Reqs being sent to the component
        ATR_FM_AntiTheftDesireExitMode  # This parameter is used to specify the desired triggers that are to be used by the component in decidingwhen to transition to the Locked Sts
        ATR_FM_AntiTheftEncryIndicatStat  # This parameter is used to indicate if a random number seed is being Reqed, or if an encryptedpassword is being provided to the component.
        ATR_FM_AntiTheftPassword  # This parameter is the seven byte numeric code (i.e., ‘encrypted password’ or ‘key’) that is generatedbased on the Encry algorithm, the password supplied by the end user, and the random number seedgiven by the component. This parameter is sent as a numeric value utilizing the full range of 0 to 0xFFFFFFFFFFFFFF. The most significant byte is sent first, not following the rules of Table 1 found inJ1939-71
        ATS_PS_AntiTheftComponentStat  # Indicates whether or not the component can be started
        ATS_PS_AntiTheftEncrySeedIndicat  # Indicates the presence of the Encry seed random number.
        ATS_PS_AntiTheftModifyPassword  # This parameter is used to indicate whether a password Req was successfully performed, or if theReq could not be perform due to Sys constraints or if the Req was not a valid Req.
        ATS_PS_AntiTheftPasswordValid  # Indicates the presence of a validated password.
        ATS_PS_AntiTheftRandomNumber  # A seven byte random numeric code provided by the component in response to an anti-theft Req. Thisparameter is sent as a numeric value utilizing the full range of 0 to 0xFFFFFFFFFFFFFF. The mostsignificant byte is sent first, not following the rules of Table 1 found in J1939-71
        BCM_Status_BCMRespStat  # 表示BCM对ADV的响应状态。
        BCM_Status_BackBrakeLightStat  # 表示后制动灯的实际状态。
        BCM_Status_HornStat  # 表示前后喇叭的实际控制状态。
        BCM_Status_WiperStat  # 表示雨刮控制状态
        BCU_DriverSeatBeltAlert  # Indicates whether the Drv's side safety belt is not fastened to alarm
        BCU_IgnitionPstn  # 点火开关状态
        BCU_PassengerSeatBeltAlert  # Indicates whether the Pasgr side safety belt is not fastened to alarm
        BMS1_MsgChecksum
        BMS1_MsgCounter  # The message counter is used to detect situations where the transmitting ECU malfunction repeats thesame frame all the time. The receiver of the formation may use the counter parameter to detect thissituation. The transmitting device will increase the message counter in every cycle. The message counterwill count from 0 to 7 and then wrap. The values 0x8 thru 0xE are SAE reserved and should be ignoredby the receiver.Value 0xF (all bits set to 1) will indicate that the message counter is not available. Forcompatibility purposes, TSC1 should also be honored if the message counter is not available from thetransmitting device.
        BMS1_PowerBattChargeReq  # Indicates whether there is a charge Req.000：No charge Req before charge ready001：When the Chrg is ready, send the Chrg Req010：Req Chrg stop in case of recoverable fault (reservation)011：Unrecoverable fault occurs, Req for Chrg (reservation)
        BMS1_PowerBattChargeStat  # Represents the Current Charge Status of the power Battary
        BMS1_PowerBattCurrent  # Represents power Batt Curr, Ngtv value represents charge, Pstv value represents discharge.
        BMS1_PowerBattHeatStat  # Indicates the heating Sts of the power Batt
        BMS1_PowerBattSOC  # Represents the remaining charge of the power Batt
        BMS1_PowerBattSysStat  # Represents the Current working Status of the power Battary System.The first alarm is a general fault;The secondary alarm is a serious fault; (limited power)Three-level alarm for emergency failure; (electricity)
        BMS1_PowerBattVolt  # Represents the power Battary Voltage.The actual physical value ranges from 0V to 1000V.
        BMS5_BMSMainNgtvCoilDrvStat  # BMS primary negative coil drive state
        BMS5_BattPackHeatCtrlCmdNgtv  # Indicates the Battery Pack Heating Negative Relay Control Command Signal
        BMS5_BattPackHeatCtrlCmdPstv  # Indicates the Battery Pack Heating Positive Relay Control Command Signal
        BMS5_ChargePlug2ConnectionStat  # Represents the connection Sts of Chrg plug 2. The signal can only be obtained when the dual gun ischarged (cc2-2)
        BMS5_ChargePlugConnectionStat  # ndicates the connection Sts of the Chrg plug.If the dual gun is charged, the signal indicates cc2-1.
        BMS5_ChargeRelayStatNgtv  # Represents the state of charging positive relay.
        BMS5_ChargeRelayStatPstv  # Represents the state of charging positive relay.
        BMS5_MainNgtvRelayDisconnectReq  # Main Negative Relay Disconnect Request Represents that BMS sends the main-Ngtv relay disconnect Req to HCU: When the HCU has no response, the BMS will actively disconnect the main-Ngtv relay after 30s
        BMS5_MainNgtvRelayStat  # Represents the state of the main-negative relay:
        BMS5_PowerBattSOH  # Represents the Batt health Sts, and the value range is 0-100%.
        CCVS1_BrakeSwitch  # Swch signal which indicates that the Drv operated Brk foot pedal is being pressed. This Brk footpedal is Ctrlling the Vhcls' service Brk (total Vhcl braking application, not park Brks). It isnecessary for safe drivetrain behavior that the Swch activates before the physical braking componentsare activated (i.e. Disengage the cruise Ctrl function prior to the activation of friction Brks).
        CCVS1_ClutchSwitch  # Swch signal which indicates that the clutch pedal is being pressed. It is necessary for a safe drivetrainbehavior that the clutch Swch is set before the clutch is opened (cruise Ctrl function).
        CCVS1_CruiseCtrlEnbSwitch  # Swch signal which indicates that it is possible to manage the cruise Ctrl function
        CCVS1_CruiseCtrlPauseSwitch  # Swch signal which indicates the Postn of the Cruise Ctrl Pause Swch used on Rmot CruiseCtrl applications.
        CCVS1_CruiseCtrlResumeSwitch  # Swch signal of the cruise Ctrl activator which indicates that the activator is in the Postn 'resume.'
        CCVS1_CruiseCtrlSetSpd  # Value of set (chosen) velocity of velocity Ctrl Sys.
        CCVS1_CruiseCtrlSetSwitch  # Swch signal of the cruise Ctrl activator which indicates that the activator is in the Postn 'set.'
        CCVS1_CruiseCtrlState  # This parameter is used to indicate the Curr Sts, or mode, of operation by the cruise Ctrl device
        CCVS1_PBSwitch  # Switch signal which indicates when the parking brake is set. In general the switch actuated by the operator's park brake control, whether a pedal, lever or other control mechanism (see also SPN 619 and 5275).
        CCVS1_PTOManagmentState  # 用于表示当前PTO处于的状态
        CCVS1_WheelBasedVehSpd  # Speed of the vehicle as calculated from wheel or tailshaft speed.
        CruiseCtrlActive  # Cruise Ctrl is Swched on. It is not ensured that the Eng is Ctrlled by cruise Ctrl, as in the caseof a large Drv's demand the Eng is Ctrlled by the Drv while cruise Ctrl is active (maximumselection of cruise Ctrl and Drv's demand). The cruise Ctrl is set to 0 if a Swch off conditionoccurs.
        CVW_GrossCombineVehWeight  # The total weight of the truck and all attached trailers.
        CVW_PoweredVehWeight  # Total mass imposed by the tires of the powered Vhcl on the road surface. Does not include the trailer.
        DC2_LockStatOfDoor1  # Signal which indicates lock Sts of Drv door
        DC2_LockStatOfDoor2  # Signal which indicates lock Sts of Pasgr door.
        DC2_OpenStatOfDoor1  # Signal which indicates open Sts of Drv door. Open Sts of bus door 1
        DC2_OpenStatOfDoor2  # Signal which indicates open Sts of Pasgr door. Open Sts of bus door 2
        DM1_ABS_AmberWarningLamp  # 琥珀色警示灯状态
        DM1_ABS_FMI  # FMI用于定义对SPN标识的子系统检测到的故障的类型（第5位是最高有效位）
        DM1_ABS_MalfunctionIndicatorLamp  # 故障指示灯状态
        DM1_ABS_OccurrenceCount  # 故障发生次数 标识该故障由当前故障转变为历史故障的次数，如果故障发生次数不可知则全置位1
        DM1_ABS_ProtectLamp  # 保护灯状态
        DM1_ABS_RedStopLamp  # 红色停止灯状态
        DM1_ABS_SPN3MmostSignificantBit  # SPN， 3个最高有效位 （第8位是最高有效位）
        DM1_ABS_SPN8_LeastSignificantBit  # 故障SPN的8个最低有效位（CM=0） （第8位是最高有效位）
        DM1_ABS_SPNConversionMethod  # 故障SPN转换方式（CM）
        DM1_ABS_SPN_secondByteOfSPN  # 故障SPN的第二字节（CM=0） （第8位是最高有效位）
        DM1_APCU_AmberWarningLamp  # 琥珀色警示灯状态 当检测到车辆系统存在非关键性故障时，需要点亮琥珀色报警灯。这时，并不要求立即停车处理
        DM1_APCU_FMI  # FMI用于定义对SPN标识的子系统检测到的故障的类型
        DM1_APCU_OccurrenceCount  # 标识该故障由当前故障转变为历史故障的次数，如果故障发生次数不可知则全置位1
        DM1_APCU_RedStopLamp  # 红色停止灯状态 如果检测到的危险性故障，会设置红色报警状态。这时，车辆必须停止。
        DM1_APCU_SAELamp_Reserved  # SAE保留分配灯状态
        DM1_APCU_SPN3MmostSignificantBit  # SPN， 3个最高有效位 （第8位是最高有效位）
        DM1_APCU_SPNConversionMethod  # SPN转换方式,始终是0
        DM1_APCU_SPN_LeastSignificantBit  # SPN， 8个最低有效位 （第8位是最高有效位）
        DM1_APCU_SPN_secondByteOfSPN  # SPN， SPN第二字节 （第8位是最高有效位）
        DM1_BCM_AmberWarningLamp  # 琥珀色警示灯状态 当检测到车辆系统存在非关键性故障时，需要点亮琥珀色报警灯。这时，并不要求立即停车处理
        DM1_BCM_FMI  # FMI用于定义对SPN标识的子系统检测到的故障的类型
        DM1_BCM_OccurrenceCount  # 标识该故障由当前故障转变为历史故障的次数，如果故障发生次数不可知则全置位1
        DM1_BCM_RedStopLamp  # 红色停止灯状态 如果检测到的危险性故障，会设置红色报警状态。这时，车辆必须停止。
        DM1_BCM_SAELamp_Reserved  # SAE保留分配灯状态
        DM1_BCM_SPN3MmostSignificantBit  # SPN， 3个最高有效位 （第8位是最高有效位）
        DM1_BCM_SPN8_LeastSignificantBit  # SPN， 8个最低有效位 （第8位是最高有效位）
        DM1_BCM_SPNConversionMethod  # SPN转换方式,始终是0
        DM1_BCM_SPN_secondByteOfSPN  # SPN， SPN第二字节 （第8位是最高有效位）
        DM1_BMS_AmberWarningLamp  # 琥珀色警示灯状态 当检测到车辆系统存在非关键性故障时，需要点亮琥珀色报警灯。这时，并不要求立即停车处理
        DM1_BMS_FMI  # FMI用于定义对SPN标识的子系统检测到的故障的类型
        DM1_BMS_OccurrenceCount  # 标识该故障由当前故障转变为历史故障的次数，如果故障发生次数不可知则全置位1
        DM1_BMS_RedStopLamp  # 红色停止灯状态 如果检测到的危险性故障，会设置红色报警状态。这时，车辆必须停止。
        DM1_BMS_SAELamp_Reserved  # SAE保留分配灯状态
        DM1_BMS_SPN3MmostSignificantBit  # SPN， 3个最高有效位 （第8位是最高有效位）
        DM1_BMS_SPN8_LeastSignificantBit  # SPN， 8个最低有效位 （第8位是最高有效位）
        DM1_BMS_SPNConversionMethod  # SPN转换方式,始终是0
        DM1_BMS_SPN_secondByteOfSPN  # SPN， SPN第二字节 （第8位是最高有效位）
        DM1_DCDC2_AmberWarningLamp  # 琥珀色警示灯状态 当检测到车辆系统存在非关键性故障时，需要点亮琥珀色报警灯。这时，并不要求立即停车处理
        DM1_DCDC2_FMI  # FMI用于定义对SPN标识的子系统检测到的故障的类型
        DM1_DCDC2_OccurrenceCount  # 标识该故障由当前故障转变为历史故障的次数，如果故障发生次数不可知则全置位1
        DM1_DCDC2_RedStopLamp  # 红色停止灯状态 如果检测到的危险性故障，会设置红色报警状态。这时，车辆必须停止。
        DM1_DCDC2_SAELamp_Reserved  # SAE保留分配灯状态
        DM1_DCDC2_SPNConversionMethod  # SPN转换方式,始终是0
        DM1_DCDC2_SPNMmostSignificantBit  # SPN， 3个最高有效位 （第8位是最高有效位）
        DM1_DCDC2_SPN_LeastSgnificantBit  # SPN， 8个最低有效位 （第8位是最高有效位）
        DM1_DCDC2_SPN_secondByteOfSPN  # SPN， SPN第二字节 （第8位是最高有效位）
        DM1_EPB_AmberWarningLamp  # 琥珀色警示灯状态
        DM1_EPB_FMI  # FMI用于定义对SPN标识的子系统检测到的故障的类型（第5位是最高有效位）
        DM1_EPB_MalfunctionIndicatorLamp  # 故障指示灯状态
        DM1_EPB_OccurrenceCount  # 故障发生次数 标识该故障由当前故障转变为历史故障的次数，如果故障发生次数不可知则全置位1
        DM1_EPB_ProtectLamp  # 保护灯状态
        DM1_EPB_RedStopLamp  # 红色停止灯状态
        DM1_EPB_SAELamp_Reserved  # SAE保留分配灯状态
        DM1_EPB_SPN3MmostSignificantBit  # SPN， 3个最高有效位 （第8位是最高有效位）
        DM1_EPB_SPN8_LeastSignificantBit  # 故障SPN的8个最低有效位（CM=0） （第8位是最高有效位）
        DM1_EPB_SPNConversionMethod  # 故障SPN转换方式（CM）
        DM1_EPB_SPN_secondByteOfSPN  # 故障SPN的第二字节（CM=0） （第8位是最高有效位）
        DM1_EPS_AmberWarningLamp  # 琥珀色警示灯状态
        DM1_EPS_FMI  # FMI用于定义对SPN标识的子系统检测到的故障的类型（第5位是最高有效位）
        DM1_EPS_MalfunctionIndicatorLamp  # 故障指示灯状态
        DM1_EPS_OccurrenceCount  # 故障发生次数 标识该故障由当前故障转变为历史故障的次数，如果故障发生次数不可知则全置位1
        DM1_EPS_ProtectLamp  # 保护灯状态
        DM1_EPS_RedStopLamp  # 红色停止灯状态
        DM1_EPS_SAELamp_Reserved  # SAE保留分配灯状态
        DM1_EPS_SPN3MmostSignificantBit  # SPN， 3个最高有效位 （第8位是最高有效位）
        DM1_EPS_SPN8_LeastSignificantBit  # 故障SPN的8个最低有效位（CM=0） （第8位是最高有效位）
        DM1_EPS_SPNConversionMethod  # 故障SPN转换方式（CM）
        DM1_EPS_SPN_secondByteOfSPN  # 故障SPN的第二字节（CM=0） （第8位是最高有效位）
        DM1_PTU_AmberWarningLamp  # 琥珀色警示灯状态 当检测到车辆系统存在非关键性故障时，需要点亮琥珀色报警灯。这时，并不要求立即停车处理
        DM1_PTU_FMI  # FMI用于定义对SPN标识的子系统检测到的故障的类型
        DM1_PTU_OccurrenceCount  # 标识该故障由当前故障转变为历史故障的次数，如果故障发生次数不可知则全置位1
        DM1_PTU_RedStopLamp  # 红色停止灯状态 如果检测到的危险性故障，会设置红色报警状态。这时，车辆必须停止。
        DM1_PTU_SAELamp_Reserved  # SAE保留分配灯状态
        DM1_PTU_SPN3MmostSignificantBit  # SPN， 3个最高有效位 （第8位是最高有效位）
        DM1_PTU_SPN8_LeastSignificantBit  # SPN， 8个最低有效位 （第8位是最高有效位）
        DM1_PTU_SPNConversionMethod  # SPN转换方式,始终是0
        DM1_PTU_SPN_secondByteOfSPN  # SPN， SPN第二字节 （第8位是最高有效位）
        DM1_TPMS_AmberWarningLamp  # 琥珀色警示灯状态
        DM1_TPMS_FMI  # FMI用于定义对SPN标识的子系统检测到的故障的类型（第5位是最高有效位）
        DM1_TPMS_MalfunctionLamp  # 故障指示灯状态
        DM1_TPMS_OccurrenceCount  # 故障发生次数 标识该故障由当前故障转变为历史故障的次数，如果故障发生次数不可知则全置位1
        DM1_TPMS_ProtectLamp  # 保护灯状态
        DM1_TPMS_RedStopLamp  # 红色停止灯状态
        DM1_TPMS_SAELamp_Reserved  # SAE保留分配灯状态
        DM1_TPMS_SPN3MmostSignificantBit  # SPN， 3个最高有效位 （第8位是最高有效位）
        DM1_TPMS_SPNConversionMethod  # 故障SPN转换方式（CM）
        DM1_TPMS_SPN_LeastSignificantBit  # 故障SPN的8个最低有效位（CM=0） （第8位是最高有效位）
        DM1_TPMS_SPN_secondByteOfSPN  # 故障SPN的第二字节（CM=0） （第8位是最高有效位）
        EBC1_ABSActive  # State signal which indicates that the ABS is active. The signal is set active when wheel brake pressure actually starts to bemodulated by ABS and is reset to passive when all wheels are in a stable condition for a certain time. The signal can also be setactive when driven wheels are in high slip (e.g., caused by retarder). Whenever the ABS system is not fully operational (due to adefect or during off-road ABS operation) , this signal is only valid for that part of the system that is still working. When ABS isswitched off completely, the flag is set to passive regardless of the current wheel slip conditions.
        EBC1_ABSFullyOperational  # Signal which indicates whether an ABS system is fully operational or whether its functionality is reduced by a defect or by anintended action (e.g., by activation of an ABS-off-road switch or during special diagnostic procedures). There are cases where thesignal is necessary to fulfill legal regulations for special applications (e.g., switching off integrated retarders).
        EBC1_ABSOffroadSwitch  # Switch signal which indicates the position of the ABS off-road switch.
        EBC1_ABSOrEBSAmberWarnSignal  # This parameter commands the ABS/EBS amber/yellow optical warning signal
        EBC1_ASRBrakeCtrlActive  # State signal which indicates that ASR brake control is active. Active means that ASR actually controls wheel brake pressure atone or more wheels of the driven axle(s).
        EBC1_ASREngCtrlActive  # State signal which indicates that ASR engine control has been commanded to be active. Active means that ASR actually tries tocontrol the engine. This state signal is independent of other control commands to the engine (e.g., from the transmission) whichmay have higher priority.
        EBC1_ASRHillHolderSwitch  # Switch signal which indicates the position of the ASR 'hill holder' switch.
        EBC1_ASROffroadSwitch  # Switch signal which indicates the position of the ABS off-road switch.
        EBC1_ATCOrASRInfoSignal  # This parameter commands the ATC/ASR driver information signal, for example a dash lamp.
        EBC1_BrakePedalPstn  # Ratio of brake pedal position to maximum pedal position. Used for electric brake applications. 0% means no braking.Also whenthere are two brake pedals on the machine,the maximum of the two should be transmitted for Brake Pedal Position.
        EBC1_EBSBrakeSwitch  # Switch signal which indicates that the brake pedal is being pressed.The EBS brake switch is independent of the brake light switchand has no provisions for external connections.
        EBC1_EBSRedWarnSignal  # This parameter commands the EBS red optical warning signal
        EBC1_SourceAddressOfCtrlDevice  # The source address of the SAE J1939 device currently controlling the brake system.
        EBC1_TractorMountTrailerABSWarn  # This parameter commands the tractor-mounted trailer ABS optical warning signal.
        EBC2_FrontAxleSpeed  # 前轴平均速度 数值范围0-0xFAFF，当前轴中一轮出现故障时，将发送另一轮正常轮速，两轮故障时输出0xFEFF
        EBC2_RelativeSpdFrontAxleLWhl  # 前轴左侧轮相对于前轴的速度 数值范围0-0xFA，轮故障时输出0xFE，无效值0xFF
        EBC2_RelativeSpdFrontAxleRWhl  # 前轴右侧轮相对于前轴的速度
        EBC2_RelativeSpdRearAxle1LWhl  # 后轴左侧轮相对于前轴的速度
        EBC2_RelativeSpdRearAxle1RWhl  # 后轴右侧轮相对于前轴的速度
        EBC2_RelativeSpdRearAxle2LWhl  # 第二轴左侧轮相对于前轴的速度
        EBC2_RelativeSpdRearAxle2RWhl  # 第二轴右侧轮相对于前轴的速度
        EBC5_BrakeTempWarning  # This parameter indicates if the temperature in the service brakes exceeds a certain value.It can be used for a warning information for the driver. The temperature warning valueis vehicle manufacturer specific.
        EBC5_EmergencyBrakeActive  # Signal which indicates an emergency braking situation (ref. ECE Regulation 13 paragraph 5.2.1.31) with high deceleration values. This signal can be used to activate the hazard lights (ref ECE Regulation 48 paragraph 6.23) to indicate other road users to the rear and front of the vehicle that a high retardation force has been applied to the vehicle relative to the prevailing road conditions.
        EBC5_FoundationBrakeUse  # This parameter indicates if the brake system presently uses the foundation brakes.
        EBC5_HaltBrakeMode  # Signal which indicates the current mode of the halt brake function.
        EBC5_HillHolderMode  # Signal which indicates the current mode of the hill holder function.
        EBC5_XBRAccelLim  # The brake system may temporarily or generally limit the maximum brake performance available for external systems. A temporary limit may be nessary due to high brake temperature; a general limit may be defined by the vehicle manufacturer, e.g. a value of -2.5 m/s? due to liability reasons. The actual limit is communicated to the external systems that request braking. The limit is only effective in the XBR Priorities 01b to 11b. It is specified as an absolute acceleration in reference to the road.
        EBC5_XBRActiveCtrlMode  # This parameter indicates which XBR Control Mode is executed by the brake system
        EBC5_XBRSysState  # This parameter indicates which external brake control is allowed.
        EC_EM1_EngReferenceTrq  # This parameter is the 100% reference value for all defined indicated engine torque parameters. It isonly defined once and doesn't change if a different engine torque map becomes valid.
        EC_EM1_EngSpdAtPoint1  # Stationary low idle speed of engine which includes influences due to engine temperature (after powerup) and other stationary changes (calibration offsets, sensor failures, etc).This parameter is point 1 ofthe engine configuration map
        EC_EM1_SupportVariableRateTSC1  # This parameter indicates which TSC1 transmission rates are supported by the engine ECU in additionto the required 10ms transmission rate for temporary powertrain control purposes. Suggest to send 0xEF.
        EEC2_AccelPedal1LowIdleSwitch  # Switch signal which indicates the state of the accelerator pedal 1 low idle switch.
        EEC2_AccelPedalKickdownSwitch  # Switch signal which indicates whether the accelerator pedal kickdown switch is opened or closed.
        EEC2_AccelPedalPstn  # The ratio of actual accelerator pedal position to maximum pedal position. Although it is used as aninput to determine powertrain demand, it also provides anticipatory information to transmission andASR algorithms about driver actions.
        EEC2_PercentLoadAtCurrentSpd  # The ratio of actual engine percent torque (indicated) to maximum indicated torque available at thecurrent engine speed, clipped to zero torque during engine braking
        ENGSC_FM_EngStartAbortReq  # Indicates the sender’s desire to abort an Eng start. This signal is used by Reqers and consenters toReq that the arbitrator cancel an Eng start that is in progress.
        ENGSC_FM_EngStartReq  # Indicates the sender’s desire to start the Eng. The Eng start arbitrator latches this signal and, ifpossible, completes the Eng start regardless of a change of Sts of this signal. Use Eng Start AbortReq (SPN 7747) to un-latch the start Req and cancel an Eng start that is in progress.
        ENGSC_FM_MsgChecksum  # Checksum to allow detection of data integrity issues. The receiving node shall calculate the checksum andcompare its calculated value with the received checksum. In case of a mismatch the message shall bediscarded.The message checksum is calculated using the first 7 data bytes, including the message counter, and thebytes of the message identifier. It is calculated as follows:Checksum = (Byte1 + Byte2 + Byte3 + Byte4 + Byte5 + Byte6 + Byte7 + message ID low byte +message ID mid low byte + message ID mid high byte + message ID high byte)
        ENGSC_FM_MsgCounter  # Message counter to allow detection of data integrity issues. The counter is incremented every time adevice sends out the Eng Start Ctrl message. When the counter has reached a value of 15 it startsover at 0 for the next message cycle. Receiving devices shall treat the message content as invalid whentwo consecutive messages from the same source address contain non-sequential counter values.
        EPB1_AmberWarnLampStat  # 黄色警示灯状态
        EPB1_EPBHCUInParkState  # EPB HCU in parking state
        EPB1_EPBHCUInReleaseState
        EPB1_PressOfSpringBrakeChamber  # Pressure of spring brake chamber of EPBEPB弹簧制动气室的压力
        EPB1_PstnOfEPBHCU
        EPB1_ReasonForInhibitOfApply  # Reason for inhibition of EPB apply
        EPB1_ReasonForInhibitOfRelease  # Reason for inhibition of EPB releaseEPB释放抑制的原因
        EPB1_RedStopLampStat
        EPB1_StateOfEPB  # FE: Error FF: Not available
        EPB1_StateOfInhibitOfEPBApply  # FE: Error FF: Not available
        EPB1_StateOfInhibitOfEPBRelease  # State of inhibition of EPB releaseEPB释放抑制状态
        EPB1_TrailerTestActivationState  # Trailer test activation state拖车试验激活状态
        EPB1_WorkModeOfEPB  # FE: Error FF: Not available
        EPS1_ColumnTrq  # Column torque measured by the torque sensor.Value type: Signed.CAN Range: 0xD800 (Min), 0x2800 (Max). 方向盘扭矩
        EPS1_ColumnTrqQF  # Quality Factor for Column Torque signal. Valid (1) or invalid (0). Value type: Unsigned. 品质因数
        EPS1_ColumnVelocity  # Column velocity measured by the motor encoder. Value type: Signed.CAN Range: 0xEC00 (Min), 0x1400 (Max). 方向盘转速
        EPS1_ColumnVelocityQF  # Quality Factor for Column Velocity signal. Valid (1) or invalid (0). Value type: Unsigned.
        EPS1_HandsOffDetected  # Hands Off Detected Sts, ON (1), OFF (0). Value type: Unsigned.
        EPS1_HandsOnDetected  # Hands On Detected Sts, ON (1), OFF (0). Value type: Unsigned.
        EPS1_IgnitionState  # Ignition signal Sts, Ignition ON (1), Ignition OFF (0). Value type: Unsigned.
        EPS1_MessageChecksum
        EPS1_MessageCounter  # Same as SPN 3689. The message counter is to verify the signal path from the demanding device to the Strg Ctrller. Thesupport of this parameter is mandatory.Note: The initial value of the 4 bit message counter for the first message during a driving cycle is arbitrary. In every followingmessage the counter is incremented by 1 (0 follows 15).
        EPS1_PullCompensation  # The purpose of pull compensation is to act as an integrator to remove any average torque on the handWhl. This is necessary toallow the handWhl to be held off-center for a prolonged period of time without handWhl torque. Value type: Signed.CAN Range: 0xB380 (Min), 0x4C80 (Max). 拉力补偿的目的是作为一个积分器去除方向盘上的任何平均扭矩。这是必要的，以允许方向盘在没有手动扭矩的情况下长时间保持偏心。
        EPS2_AbsSteerPstn  # The absolute Strg Postn measured by the angle sensor. Value type: Signed.CAN Range: 0xB380 (Min), 0x4C80 (Max). 方向盘绝对位置，左负右正
        EPS2_AbsSteerPstnQF
        EPS2_ActualMode  # The actual mode is ReAX working.
        EPS2_ExtInputCmdEcho  # This is an echo of the external input Cmd. Input can be in Nm or Deg, depending on mode used. Value type: Signed. CANRange: 0xB380 (Min), 0x4C80 (Max). 外部输入的控制值
        EPS2_MessageChecksum
        EPS2_MessageCounter  # Same as SPN 3689. The message counter is to verify the signal path from the demandingdevice to the steering controller. The support of this parameter is mandatory.Note: The initial value of the 4 bit message counter for the first message during a drivingcycle is arbitrary. In every following message the counter is incremented by 1 (0 follows15
        EPS2_ReqMode  # This is an echo of the Req operating mode from PropB_FE. 对lcks_cmd控制报文的响应
        EPS2_StatusOrError  # Each bit in this byte indicates a seperate Sts flag. Bit 1 - Sys_NEEDS_INITIAL_STARTING_Postn Bit 2 - INVAILID_OPERATING_MODE Bit 3 - EXT_INPUT_Cmd_ERROR Bit 4 - Vhcl_SPEED_MISSING Bit 5 - COLUMN_DRIVE_IN_SLEEP_MODE Bit 6 - MAXIMUM_MOTOR_TORQUE_ACHIEVED Bit 7 - INTERNAL_COLUMN_DRIVE_ERROR Error状态，每一位表示一个独立的Error状态： bit 1:系统需初始化起始位置； bit 2:无效的操作模式； bit 3:外部输入指令错误； bit 4:车速丢失； bit 5:转向柱驱动处于睡眠模式； bit 6:已达到电机最大扭矩； bit 7:内部转向柱驱动错误
        EPSO1_AmberWarnLampStat  # 应急转向状态下的黄色指示灯状态
        EPSO1_ElectricalSteerSupRedLv  # 转向助力扭矩降低百分比。当系统出现故障时，电机将降额运行。
        EPSO1_EmergencySteerStat  # 应急转向状态信号，表示是否处在应急转向状态0:上电自检应急转向功能 1:正常情况下，发1（非应急转向功能） 2:处于正常转向和应急转向之间的状态，转向力已沉重，但还未到应急转向的情况 3:应急转向工作 4:应急转向无法使用（由于故障等原因无法使用应急转向）
        EPSO1_MessageChecksum  # EPSIx和EPSOx报文的CRC算法： MessageBuffer[0] = EPSI1.byte(0); MessageBuffer[1] = EPSI1.byte(1); MessageBuffer[2] = EPSI1.byte(2); MessageBuffer[3] = EPSI1.byte(3); MessageBuffer[4] = EPSI1.byte(4); MessageBuffer[5] = EPSI1.byte(5); MessageBuffer[6] = EPSI1.byte(6); MessageBuffer[7] = EPSI1.byte(7); Crc8 = CalculateCrc8(MessageBuffer, 0x07, 0x14, 0x9B, 0xFF); //标黄色的0x14是源地址+1，EPS源地址为0x13. byte CalculateCrc8(byte DataArray_u8[], word DataLength_u16, byte StartValueCrc_u8, byte GeneratorPolynom_u8, byte FinalExOr_u8) { word ByteCounter_16 = 0; byte BitCounter_u8 = 0; byte Crc_u8 = 0; Crc_u8 = StartValueCrc_u8; for(ByteCounter_16 = 0; ByteCounter_16
        EPSO1_MessageCounter
        EPSO1_RedStopLampState  # 应急转向状态下的红色指示灯状态
        EPSO1_SteerAng  # 转向角度，经过转向机修正后的值，用于上层控制
        EPSO1_SteerAngSpd  # 转向角速度
        EPSO1_SysState  # 系统状态 0000 undefined 未定义（客户无需接入） 0001 Nmwait（int）未唤醒时的状态，等待网络唤醒。此时未上15电。 0010 terminal30wait 未使用，客户无需接入 0011 predrive 上15电自检过程 0100 drivedown 15电上电完成，自检完成无错误，CAN网络正常，发动机未起动 0101 driveup 发动机起动完成，无错误 0110 postrun 下电过程中 0111 off 下电完成进入OFF 1000 error 错误 1001 flash 刷写时进入的状态，本项目不用 1010 lowvolt 低压状态，本项目不用 1110 ERR 信号错误 1111 SNA 信号不可用
        EPSO2_DriverTrq  # 驾驶员手力矩
        EPSO2_ExtCtrlMode  # 外部控制功能状态。 0x0:外部控制关闭，上电默认进入此状态 0x1:外部控制功能开启，进入等待状态，来自上层控制的反馈 0x2:外部控制功能中的手力矩控制模式，来自上层控制的反馈 0x3:外部控制功能中的电机扭矩控制模式，来自上层控制的反馈 0x4:外部控制功能中的方向盘转角控制模式，来自上层控制的反馈 0x5:外部控制功能中的取消控制，来自上层控制的反馈 0x6:外部控制被锁，表示进入严重错误，当前驾驶循环内无法再响应外部控制命令，相当于ERROR。此状态客户无需发送。
        EPSO2_HandsOffProbability  # 脱手检测可信度，100%代表完全确信驾驶员已脱手
        EPSO2_MessageChecksum  # EPSIx和EPSOx报文的CRC算法： MessageBuffer[0] = EPSI1.byte(0); MessageBuffer[1] = EPSI1.byte(1); MessageBuffer[2] = EPSI1.byte(2); MessageBuffer[3] = EPSI1.byte(3); MessageBuffer[4] = EPSI1.byte(4); MessageBuffer[5] = EPSI1.byte(5); MessageBuffer[6] = EPSI1.byte(6); MessageBuffer[7] = EPSI1.byte(7); Crc8 = CalculateCrc8(MessageBuffer, 0x07, 0x14, 0x9B, 0xFF); //标黄色的0x14是源地址+1，EPS源地址为0x13. byte CalculateCrc8(byte DataArray_u8[], word DataLength_u16, byte StartValueCrc_u8, byte GeneratorPolynom_u8, byte FinalExOr_u8) { word ByteCounter_16 = 0; byte BitCounter_u8 = 0; byte Crc_u8 = 0; Crc_u8 = StartValueCrc_u8; for(ByteCounter_16 = 0; ByteCounter_16
        EPSO2_MessageCounter
        EPSO2_MotorTrq  # 电机扭矩
        EPSO2_SteerWheelVibrationMode  # 方向盘震动模式
        ESC1_ActualInnerWheelSteerAng  # 轮胎内轮转角（内轮的偏航角）
        ESC1_AxleLocation  # To identify to which of several similar devices (such as tires or fuel tanks) the information applies.
        ESC1_AxleLoweringInhibit  # A signal which indicates if lowering of lifted axle is allowed or inhibited.
        ESC1_StatOfSteerAxle  # 转向轴状态
        ESC1_SteerType  # Indicates the different types of steering systems (ref. ECE Regulation 79 paragraph 2.5)
        ESC1_TypeOfSteerForces  # Type of Steering Forces (Ref. ECE Regulation 79 paragraph 2.5)
        ESC1_TypeOfSteerTrans  # Type of Steering Transmission (Ref. ECE Regulation 79 paragraph 2.6)
        ETC2_TransActualGearRatio  # Actual ratio of input shaft speed to output shaft speed
        ETC2_TransCurrentGear  # The gear currently engaged in the transmission or the last gear engaged while the transmission is in the process of shifting to the new or selected gear
        ETC2_TransSelectedGear  # The gear that the transmission will attempt to achieve during the current shift if a shift is in progress, or the next shift if one is pending
        FBCM_BackMirrorAdjustSwch  # indicate the selected position of the back mirror adjustment switch.
        FBCM_BackMirrorHeatSwitch  # Swch signal which indicates the Sts of menu “back Mirr heat“. It is the nonlocking Swch, thesignal value should be 1 during the Swch be pressed
        FBCM_BackMirrorSelectSwitch  # Indicates the status of back mirror selection switch..
        FBCM_CabDoorsLockSwitch  # Indicates the status of cab doors lock/unlock central control switch.Used the signal to collect data forfrequency statistics.
        FBCM_DriverCtrlPasgrWindowSwitch  # Indicates the status of driver control passenger window switch.Used the signal to collect data forfrequency statistics.
        FBCM_DriverWindowSwitch  # Indicates the status of driver window switch.Used the signal to collect data for frequency statistics.
        FBCM_LockOrUnlockSuccessAlert  # Signal which indicates whether there is a lock/unlock success alert.If Lock/Unlock is not success, then 0x3 is sent.
        FBCM_PassengerWindowSwitch  # Indicates the status of passenger window switch.Used the signal to collect data for frequencystatistics.
        FBCM_RMKeyBattStat  # indicate status of current remote key battery. If the current remote key battery is too low, signalRMKeyBatterySt will be set to warning driver change remote key battery.
        FBCM_RmtLightInspectCmd  # Indicates the command of light inspection. DCM is the arbitration of light inspection function whichactivated by remote key.
        FBCM_RmtSearchVehCmd  # Indicates the command of remote search vehicle and light self-inspection. DCM is the arbitration ofremote search vechicle function which activated by remote key.
        FBCM_VehAntiTheftStat  # Indicates the status of vehicle anti-theft.
        HCU_BMS_EnduranceMileage  # Indicates the mileage, used for the display of the instrument.The actual physical value range is 0km-500km
        HCU_BMS_HCUSysStat  # 表示整车控制器系统工作状态：
        HCU_BMS_HighVoltSysFailStat  # Indicates High Voltage System Failure Status. Level 1 failure: alarm； Level 2 failure: limit； Level 2 failure: Shut Down
        HCU_BMS_PermitCharge  # Indicates whether Charge is allowed.
        HCU_BMS_ReadyToDriveStat  # 表示整车运行准备就绪状态。
        HCU_BMS_SleepCmd  # Indicates the sleep Cmd sent by HCU. After receiving it, the receiving node realizes the sleep wakefunction according to the network sleep wake strategy.
        LC_BackUpLightAndAlarmHornCmd  # 倒车灯和蜂鸣器指令
        LC_CenterStopLightCmd  # Command to activate or de-activate the tractor and implement center stop light
        LC_DriverSideDomeLight  # Swch signal which indicates the Sts of “Drv Side Reading Light“. It is the nonlocking Swch, the signal valueshould be 1 during the Swch be pressed.
        LC_HighBeamHeadLightCmd  # 远光灯指令
        LC_ImplementMarkerLightCmd  # 侧标志灯、位置灯、牌照灯等
        LC_LeftTurnSignalLightsCmd  # 左转向灯指令
        LC_LowBeamHeadLightCmd  # 近光灯指令
        LC_PassengerSideDomeLight  # Swch signal which indicates the Sts of “Pasgr Side Cab Dome Light“. It is the nonlocking Swch, the signalvalue should be 1 during the Swch be pressed.
        LC_RearFogLightCmd  # 后雾灯指令
        LC_RightTurnSignalLightsCmd  # 右转向灯指令
        LC_RunLightCmd  # 行车灯指令
        LC_TractorFrontFogLightsCmd  # 前雾灯指令
        LD_BackUpLightAndAlarmHorn  # 倒车灯和蜂鸣器状态
        LD_CenterStopLight  # This parameter provides measured data from the tractor and attached implement center stop lights.
        LD_FrontFogLights  # 前雾灯的状态
        LD_HighBeamHeadLightData  # 远光灯状态
        LD_ImplementMarkerLightData  # 表示位置灯的状态
        LD_LeftTurnSignalLights  # 左转向灯状态
        LD_LowBeamHeadLightData  # 近光灯状态
        LD_RearFogLights  # 后雾灯的状态
        LD_RightTurnSignalLights  # 右转向灯状态
        LD_RunLight  # 行车灯状态
        MCU1_ActualMotorTrqHR  # 高精度电机扭矩.表示实际电机扭矩的小数部分，与信号＜电机扭矩＞共同组成实际电机扭矩。如果b3为1表示该参数不可用。当b3为0时，b0到b2用于表示电机扭矩的高精度部分，表示精度是0.125%，表示范围是0%-0.875%。
        MCU1_HighVoltOffPermit  # 该信号是对电机高压下电请求信号的反馈。取值1表示允许下电，则整车控制器将切下电机母线侧的高压继电器。
        MCU1_MaxOutputMotorTrq  # 表示电机可用最大电动转矩。实际取值范围为0-125%。信号以扭矩百分比形式来表示，100.0%代表电机可用最大电动转矩，电动转矩是不随转速变化的常数。＜电机可用最大电动转矩＞为电机可用最大电动转矩的整数部分，同＜电机可用最大电动高精度转矩＞共同组成电机可用最大电动转矩。
        MCU1_MaxOutputMotorTrqHR  # 表示电机可用最大电动高精度转矩的小数部分，与信号＜电机可用最大电动转矩＞共同组成电机可用电动扭矩。如果b3为1表示该参数不可用。当b3为0时，b0到b2用于表示电机扭矩的高精度部分，表示精度是0.125%，表示范围是0%-0.875%。
        MCU1_MotorDischargeStat  # 表示电机主动放电状态。 00: 主动放电未启动，未接收到电机主动放电命令或者未启动主动放电 01：主动放电进行，执行主动放电过程中 10：主动放电完成，母线电容电压在3s内降到60V以内， 主动放电完成 11：主动放电退出，执行主动放电过程因故障退出
        MCU1_MotorFaliureStat  # 电机故障状态反馈。 三级故障为最严重故障。
        MCU1_MotorRotateDirection  # 电机旋转方向（实际转向）： 00 无旋转方向输出（转速在±10rpm以内无旋转方向 输出）； 01 正向：整车前进时电机旋转方向； 10 反向：整车后退时电机旋转方向； 11 不可用。
        MCU1_MotorSpd  # 表示电机实际转速。 实际的物理值范围是0rpm-7000rpm。 实际的精度是1rpm。
        MCU1_MotorSysStat  # 电机系统状态 0x0:表示低压上电完成，但高压电未建立的状态； 0x1:表示低压上电完成，高压上电过程中； 0x2:表示高、低压上电都完成后的状态，无扭矩输出的随动状态； 0x3:表示电机系统处于正常响应指令输出的牵引或制动状态； 0x4:表示电机系统处于限功率响应指令输出的牵引或制动状态，折扣输出； 0x5:表示电机系统发生故障； 0x6:表示高压下电过程中； 0xF:表示除以上状态以外的无效状态。
        MCU1_MotorTrq  # 表示电机扭矩。正值表示要求电机处于电动状态；负值表示要求电机处于发电状态。信号以扭矩百分比形式来表示，100.0%代表电机最大输出扭矩，最大输出扭矩是不随转速变化的常数（本项目园区清扫车为450Nm）。＜电机扭矩＞为实际电机扭矩的整数部分，同＜高精
        MCU1_MotorWorkMode  # 电机工作模式（实际工作模式） 电机有四种工作状态：自由随动状模式、扭矩控制模式、转速控制模式和转子零位标定。 要求电机处于自由随动状态运行时，电机的输出扭矩为零，即不能电动也不能发电，电耗降至极小值。要求具有快速进入电动及发电的响应速度。
        MCU1_MsgChecksum
        MCU1_MsgCounter  # 报文计数器用于检测由于报文发送者故障导致重复发生同一帧报文。报文接收者可以使用报文计数器检测到这种情况。报文发送者在每个报文发送周期令报文计数器增1，报文计时器从0开始计数直到15，然后再从0开始计数。
        OWW_FrontOperatorWasherSwitch  # State of operation selected by operator switch for the washer in front of the operator position.
        OWW_FrontOperatorWiperSwitch  # State of operation selected by operator switch for the Wiper in front of the operator position.
        PS1_ESCLNotLockWarn  # Indicates the warning that ESCL can't lock when the the driver door is open.
        PS1_ESCLNotUnlockWarn  # Indicates the warning that ESCL can't unlock when the smart start button is pressed.
        PS1_EngRmtStartAndStopStat  # Indicates the engine remote start and stop status.
        PS1_IgnitionPstn  # Signal which indicates the ignition position status.
        PS1_IgnitionRmtCtrlStat  # Indicates the ignition remote control status.
        PS1_NoLegalSmartKeyIDWarn  # Indicates the warning that there is no legal smart key identified when the the smart start button ispressed.
        PS1_NoLegalSmartKeyInsideVehWarn  # Idicates the warning that there is no legal smart key inside the vehicle when the cab doors are closedwith the ignition is not off.
        PS1_PowerMainSwchNotClosed  # indicate status of Power Main Switch Not closed
        PS1_PowerOffBeforeLeaveVehWarn  # Indicates the warning when the driver left the vehicle with the ignition is not off.
        PS1_RmtLightInspectionCmd  # Indicates the command of light inspection. BCM is the arbitration of light inspection function whichactivated by remote key.
        PS1_RmtLockOrUnlockStat  # Indicates the remote lock/Unlock status.
        PS1_RmtSearchVehCmd  # Indicates the command of remote search vehicle. DCM is the arbitration of remote search vechiclefunction.
        PS1_RmtSearchVehStat  # Indicates if the vehicle remote search vehicle status.
        PS1_SmartKeyBattStat  # indicate status of current smart key battery. If the current smart key battery is too low, signal 0x1 willbe set to warning driver change remote key battery.
        PS1_SmartStartConditionWarn  # Indicates the warning that the brake pedal (Automatic) or the clutch pedal (Manual) is not pressedduring the starting process.
        PS1_TurnLightCtrlCmd  # Indicates the turning light control command.
        PS1_VehRmtCtrlMode  # Indicates if the vehicle remote control mode is activated or not.
        SC_AutoLightCtrlSwitch  # indicate the auto light Ctrl Swch
        SC_CabDoorWarnOFFSwitch  # indicate the cab door Warn off Swch
        SC_FCWSwitchStat  # Signal which indicates FCW Swch Sts. It is the nonlocking Swch, the signal value should be 1during the Swch be pressed
        SC_HornSelectionSwitch  # indicate the selected Postn of the horn selection Swch
        SC_HornSwitch  # Swch signal which indicates the Sts of menu “horn“. It is the nonlocking Swch, the signal valueshould be 1 during the Swch be pressed.
        SC_IGOffPostnLightAlert  # Signal which indicates Postn light alert Sts. When alert condition is meeted, 0x1 is sent
        SC_IndoorLightSwitch  # Swch signal which indicates the Sts of “indoor light“. It is the nonlocking Swch, the signal valueshould be 1 during the Swch be pressed
        SC_LDWSwitchStat  # Signal which indicates LDW Swch Sts. It is the nonlocking Swch, the signal value should be 1 during the Swch be pressed LDW开关状态，自复位开关
        SC_RearWorkLampSwitch  # Indicates the Sts of rear work lamp Swch
        SC_ReverseGearSwitch  # Indicates the Sts of reverse gear Swch.
        SC_SleepAreaLightSwitch  # Swch signal which indicates the Sts of “sleep area light“. It is the nonlocking Swch, the signal valueshould be 1 during the Swch be pressed.
        TIRE1_AirLeakageRate  # The pressure loss rate of a tire.
        TIRE1_ExtendTirePressSupport  # Defines the choice of using the tire pressure (PGN 65268) or Extended Tire Pressure (PGN 64578). The state value '01' indicates the extended tire pressure SPN is used for the pressure data. Any other value indicates the extended tire pressure SPN is ...
        TIRE1_Location  # Identifies which tire is associated with the parametric data in this PGN. The low order 4 bits represent a position number, counting left to right when facing in the direction of normal vehicle travel (forward). The high order 4 bits represent a ...
        TIRE1_Press  # Pressure at which air is contained in cavity formed by tire and rim.
        TIRE1_PressThresholdDetect  # Signal indicating the pressure level of the tire.
        TIRE1_Stat  # Indicates the status of the tire.
        TIRE1_Temp  # Temperature at the surface of the tire sidewall.
        TIRE2_Location  # Identifies which tire is associated with the parametric data in PGN 64578. Refer to SPN 929 for further details and examples. The low order 4 bits represent a position number, counting left to right when facing in the direction of normal vehicle .Examples: Tire pressure for location 0x00 would be left front tire.Tire pressure for location 0x23 would be right outside rear rear on a 3-axle tractor with dual axle per side (3rd axle, 4thtire).
        TIRE2_PressExtendRange  # Pressure at which air is contained in cavity formed by tire and rim. See SPN 241 for alternate tire pressure with a lower range and coarser resolution.
        TIRE2_ReqTirePress  # The required tire pressure at which air is contained in cavity formed by tire and rim. This pressure of the tire is compensated to meet the specific physical environmental conditions (temperature) of the vehicle.
        TIRE3_TireLocation  # Identifies which tire is associated with the parametric data in this PGN.The low order 4 bits represent a Postn number, counting left to right when facing in the direction of normal Vhcltravel (forward).The high order 4 bits represent a Postn number, counting front to back on the Vhcl.The value 0xFF indicates not available.It is recommended that output devices add 1 to the Postn number (range 1 to 15, not 0 to 14) for use by Drvs andservice technicians.Examples: Tire Press for location 0x00 would be left front tire.Tire Press for location 0x23 would be right outside rear rear on a 3-axle tractor with dual axle per side (3rd axle,4th tire).
        TIRE3_TireSensorElectricalFault  # Indicates the Sts of electrical fault on the tire sensor.
        TIRE3_TireSensorMatchStat  # Identifies whether the tire sensor is matched or not.
        TIRE3_TireSensorSelfLearningStat  # Identifies the self learning Sts of tire sensor.
        TIRE3_TireTemThresholdDetection  # Signal indicating the Temperature level of the tire. The levels defined represent different temperatureconditions of the tire.
        TPCM_BCM
        TPCM_BMS
        TPCM_EBS
        TPCM_EPB
        TPCM_EPS
        TPCM_TPMS
        TPDT_BCM
        TPDT_BMS
        TPDT_EBS
        TPDT_EPB
        TPDT_EPS
        TPDT_TPMS
        VCU_Status_ActualMaxDrivePctTrq  # Actual_Max_Available_Drive_Pct_Torque 当前状态下电机能够提供的最大实时相对驱动参考扭矩值的百分比，不包含此时的滑行扭矩值。
        VCU_Status_ManualAccelPedalPstn  # 表示VCU发送的油门开关信号。注：只有有人踩下才会变化
        VCU_Status_ManualBrakeSwitch  # 表示VCU发送的制动开关信号。注：只有有人踩下才会变化
        VCU_Status_VCUAutoToManualTips  # 16个位分别代表不同的条件： 位1：舒适CAN总线关闭； 位2：动力CAN总线关闭； 位3：ADV控制模式报文超时； 位4：ADV扭矩请求报文CS/LC故障； 位5：手刹开关拉下； 位6：挂车手刹开关拉下； 位7：巡航激活； 位8：油门踩下大于一定阈值； 位9：油门踏板故障时； 位10：刹车踏板踩下； 位11：刹车踏板故障时； 位12：智能驾驶功能屏蔽。
        VCU_Status_VCUMode  # 表示VCU实际工作模式状态。
        VD_TotalVehDistance  # Accumulated distance traveled by Vhcl during its operation. NOTE See SPN 917 for alternate resolution.
        VD_TripDistance  # Distance traveled during all or part of a journey. NOTE See SPN 918 for alternate resolution.
        VDC2_LateralAccel  # Indicates a lateral acceleration of the vehicle (the component of vehicle acceleration vector along the Y-axis).
        VDC2_LongitudinalAccel  # Indicates the longitudinal acceleration of the vehicle. A positive longitudinal acceleration signal results when the vehicle speedincreases, regardless of driving the vehicle forward or backward.
        VDC2_SteerWheelAng  # The main operator`s steering wheel angle (on the steering column, not the actual wheel angle). The vehicle being steered to the left (counterclockwise) results in a positive steering wheel angle. This is the yaw angle of the steering wheel with the z-axis along the centerline of the steering column.
        VDC2_SteerWheelAngSensorType  # Indicates whether the steering wheel angle sensor is capable of absolute measuring of the number of steering wheel turns or not (relative measuring to position at ignition on).
        VDC2_SteerWheelTurnCounter  # Indicates number of steering wheel turns, absolute position or relative position at ignition on. Positive values indicate left turns.
        VDC2_YawRate  # Indicates the rate of rotation about the vertical axis. A positive yaw rate signal results when the vehicle turns counter-clockwise.
    LocalizationInfo: category=STRUCTURE
      25 x element, all with category=TYPE_REFERENCE:
        Rolling_Count: implementation-data-type=UInt32
        IDC_Time_L: implementation-data-type=UInt32
        IDC_Time_H: implementation-data-type=UInt32
        SDC_Time_L: implementation-data-type=UInt32
        SDC_Time_H: implementation-data-type=UInt32
        timestamp_sec: implementation-data-type=Double
        sequence_num: implementation-data-type=Float
        position: implementation-data-type=rt_Array_Float_3
        orientation: implementation-data-type=rt_Array_Float_4
        linear_velocity: implementation-data-type=rt_Array_Float_3
        linear_acceleration: implementation-data-type=rt_Array_Float_3
        angular_velocity: implementation-data-type=rt_Array_Float_3
        heading: implementation-data-type=Float
        linear_acceleration_vrf: implementation-data-type=rt_Array_Float_3
        angular_velocity_vrf: implementation-data-type=rt_Array_Float_3
        euler_angles: implementation-data-type=rt_Array_Float_3
        linear_velocity_vrf: implementation-data-type=rt_Array_Float_3
        measurement_time: implementation-data-type=Double
        status: implementation-data-type=UInt32
        pos_llh: implementation-data-type=rt_Array_Double_3
        origin_llh: implementation-data-type=rt_Array_Double_3
        global_offset: implementation-data-type=rt_Array_Double_3
        mileage: implementation-data-type=Double
        relative_distance: implementation-data-type=Double
        relative_heading: implementation-data-type=Double
    rt_Array_Float_3: category=ARRAY
      element rt_Array_Float_3: array-size=3, array-size-semantics=FIXED-SIZE, implementation-data-type=Float
    rt_Array_Float_4: category=ARRAY
      element rt_Array_Float_4: array-size=4, array-size-semantics=FIXED-SIZE, implementation-data-type=Float
    rt_Array_Double_3: category=ARRAY
      element rt_Array_Double_3: array-size=3, array-size-semantics=FIXED-SIZE, implementation-data-type=Double
    PlanningInfo: category=STRUCTURE
      30 x element, all with category=TYPE_REFERENCE:
        Rolling_Count: implementation-data-type=UInt32
        IDC_Time_L: implementation-data-type=UInt32
        IDC_Time_H: implementation-data-type=UInt32
        SDC_Time_L: implementation-data-type=UInt32
        SDC_Time_H: implementation-data-type=UInt32
        timestamp_sec: implementation-data-type=Double
        sequence_num: implementation-data-type=UInt32
        total_path_length: implementation-data-type=Float
        total_path_time: implementation-data-type=Float
        trajectory_point_num: implementation-data-type=UInt32
        trajectory_point: implementation-data-type=TrajectoryPoint
        path_point_num: implementation-data-type=UInt32
        path_point: implementation-data-type=PathPoint
        is_estop: implementation-data-type=UInt32
        estop_reason: implementation-data-type=UInt32
        is_replan: implementation-data-type=UInt32
        replan_reason: implementation-data-type=UInt32
        gear: implementation-data-type=UInt32
        right_of_way_status: implementation-data-type=UInt32
        decision: implementation-data-type=UInt32
        task: implementation-data-type=UInt32
        lon_trajectory_type: implementation-data-type=UInt32
        lat_trajectory_type: implementation-data-type=UInt32
        scenario_type: implementation-data-type=UInt32
        driving_state: implementation-data-type=UInt32
        planning_state: implementation-data-type=UInt32
        working_mode: implementation-data-type=UInt32
        vehicle_signal: implementation-data-type=VehicleSignal
        loc_timestamp_sec: implementation-data-type=Double
        chassis_timestamp_sec: implementation-data-type=Double
    TrajectoryPoint: category=STRUCTURE
      13 x element, all with category=TYPE_REFERENCE, implementation-data-type=rt_Array_Float_100:
        x
        y
        z
        theta
        kappa
        s
        dkappa
        ddkappa
        v
        a
        relative_time
        da
        slope
    rt_Array_Float_100: category=ARRAY
      element rt_Array_Float_100: array-size=100, array-size-semantics=FIXED-SIZE, implementation-data-type=Float
    PathPoint: category=STRUCTURE
      7 x element, all with category=TYPE_REFERENCE, implementation-data-type=rt_Array_Float_100:
        x
        y
        z
        theta
        kappa
        s
        dkappa
    VehicleSignal: category=STRUCTURE
      5 x element, all with category=TYPE_REFERENCE, implementation-data-type=UInt32:
        turn_signal
        high_beam
        low_beam
        horn
        emergency_light
    ADMInfoSOC2MCU: category=STRUCTURE
      27 x element, all with category=TYPE_REFERENCE, implementation-data-type=UInt32:
        Rolling_Count
        IDC_Time_L
        IDC_Time_H
        SDC_Time_L
        SDC_Time_H
        soc_sts
        soc_reserv_1
        zloc_sts
        zloc_reserv_1
        zmap_sts
        zmap_reserv_1
        zloc_lidar_sts
        zloc_lidar_reserv_1
        perception_radar_sts
        perception_radar_reserv_1
        perception_camera_sts
        perception_camera_reserv_1
        perception_lidar_sts
        perception_lidar_reserv_1
        perception_fusion_sts
        perception_fusion_reserv_1
        prediction_sts
        prediction_reserv_1
        planning_sts
        planning_reserv_1
        routing_sts
        routing_reserv_1
    ChassisInfo: category=STRUCTURE
      131 x element, all with category=TYPE_REFERENCE:
        Rolling_Count: implementation-data-type=UInt32
        IDC_Time_L: implementation-data-type=UInt32
        IDC_Time_H: implementation-data-type=UInt32
        SDC_Time_L: implementation-data-type=UInt32
        SDC_Time_H: implementation-data-type=UInt32
        speed_mps: implementation-data-type=Float
        speed_mps_status: implementation-data-type=UInt32
        speed_mps_dT: implementation-data-type=UInt32
        wheel_spd_fl: implementation-data-type=Float
        wheel_spd_fl_status: implementation-data-type=UInt32
        wheel_spd_fl_dT: implementation-data-type=UInt32
        wheel_spd_fr: implementation-data-type=Float
        wheel_spd_fr_status: implementation-data-type=UInt32
        wheel_spd_fr_dT: implementation-data-type=UInt32
        wheel_spd_rl: implementation-data-type=Float
        wheel_spd_rl_status: implementation-data-type=UInt32
        wheel_spd_rl_dT: implementation-data-type=UInt32
        wheel_spd_rr: implementation-data-type=Float
        wheel_spd_rr_status: implementation-data-type=UInt32
        wheel_spd_rr_dT: implementation-data-type=UInt32
        longitude_acc: implementation-data-type=Float
        longitude_acc_status: implementation-data-type=UInt32
        longitude_acc_dT: implementation-data-type=UInt32
        lateral_acc: implementation-data-type=Float
        lateral_acc_status: implementation-data-type=UInt32
        lateral_acc_dT: implementation-data-type=UInt32
        accel_pedal_position: implementation-data-type=Float
        accel_pedal_position_status: implementation-data-type=UInt32
        accel_pedal_position_dT: implementation-data-type=UInt32
        brake_pedal_position: implementation-data-type=Float
        brake_pedal_position_status: implementation-data-type=UInt32
        brake_pedal_position_dT: implementation-data-type=UInt32
        gear_location: implementation-data-type=SInt32
        gear_location_status: implementation-data-type=UInt32
        gear_location_dT: implementation-data-type=UInt32
        brake_switch: implementation-data-type=UInt32
        brake_switch_status: implementation-data-type=UInt32
        brake_switch_dT: implementation-data-type=UInt32
        parking_brake_switch: implementation-data-type=UInt32
        parking_brake_switch_status: implementation-data-type=UInt32
        parking_brake_switch_dT: implementation-data-type=UInt32
        motor_reference_torque: implementation-data-type=Float
        motor_reference_torque_status: implementation-data-type=UInt32
        motor_reference_torque_dT: implementation-data-type=UInt32
        actual_motor_torque: implementation-data-type=Float
        actual_motor_torque_status: implementation-data-type=UInt32
        actual_motor_torque_dT: implementation-data-type=UInt32
        engine_reference_torque: implementation-data-type=Float
        engine_reference_torque_status: implementation-data-type=UInt32
        engine_reference_torque_dT: implementation-data-type=UInt32
        actual_engine_torque: implementation-data-type=Float
        actual_engine_torque_status: implementation-data-type=UInt32
        actual_engine_torque_dT: implementation-data-type=UInt32
        gear_ratio: implementation-data-type=Float
        gear_ratio_status: implementation-data-type=UInt32
        gear_ratio_dT: implementation-data-type=UInt32
        steering_angle: implementation-data-type=Float
        steering_angle_status: implementation-data-type=UInt32
        steering_angle_dT: implementation-data-type=UInt32
        steering_angle_velocity: implementation-data-type=Float
        steering_angle_velocity_status: implementation-data-type=UInt32
        steering_angle_velocity_dT: implementation-data-type=UInt32
        yaw_rate: implementation-data-type=Float
        yaw_rate_status: implementation-data-type=UInt32
        yaw_rate_dT: implementation-data-type=UInt32
        driver_hand_torque: implementation-data-type=Float
        driver_hand_torque_status: implementation-data-type=UInt32
        driver_hand_torque_dT: implementation-data-type=UInt32
        left_turn_signal: implementation-data-type=UInt32
        left_turn_signal_status: implementation-data-type=UInt32
        left_turn_signal_dT: implementation-data-type=UInt32
        right_turn_signal: implementation-data-type=UInt32
        right_turn_signal_status: implementation-data-type=UInt32
        right_turn_signal_dT: implementation-data-type=UInt32
        auto_drving_main_swtich: implementation-data-type=UInt32
        auto_drving_main_swtich_status: implementation-data-type=UInt32
        auto_drving_main_swtich_dT: implementation-data-type=UInt32
        high_beam_signal: implementation-data-type=UInt32
        high_beam_signal_status: implementation-data-type=UInt32
        high_beam_signal_dT: implementation-data-type=UInt32
        low_beam_signal: implementation-data-type=UInt32
        low_beam_signal_status: implementation-data-type=UInt32
        low_beam_signal_dT: implementation-data-type=UInt32
        ignition_position: implementation-data-type=UInt32
        ignition_position_status: implementation-data-type=UInt32
        ignition_position_dT: implementation-data-type=UInt32
        is_ebs_normal: implementation-data-type=UInt32
        is_ebs_normal_status: implementation-data-type=UInt32
        is_ebs_normal_dT: implementation-data-type=UInt32
        is_eps_normal: implementation-data-type=UInt32
        is_eps_normal_status: implementation-data-type=UInt32
        is_eps_normal_dT: implementation-data-type=UInt32
        is_epb_normal: implementation-data-type=UInt32
        is_epb_normal_status: implementation-data-type=UInt32
        is_epb_normal_dT: implementation-data-type=UInt32
        is_vcu_normal: implementation-data-type=UInt32
        is_vcu_normal_status: implementation-data-type=UInt32
        is_vcu_normal_dT: implementation-data-type=UInt32
        throttle_percentage: implementation-data-type=Float
        throttle_percentage_status: implementation-data-type=UInt32
        throttle_percentage_dT: implementation-data-type=UInt32
        deflector_rod: implementation-data-type=UInt32
        deflector_rod_status: implementation-data-type=UInt32
        deflector_rod_dT: implementation-data-type=UInt32
        tire_pressure_fl: implementation-data-type=Float
        tire_pressure_fl_status: implementation-data-type=UInt32
        tire_pressure_fl_dT: implementation-data-type=UInt32
        tire_pressure_fr: implementation-data-type=Float
        tire_pressure_fr_status: implementation-data-type=UInt32
        tire_pressure_fr_dT: implementation-data-type=UInt32
        tire_pressure_rl: implementation-data-type=Float
        tire_pressure_rl_status: implementation-data-type=UInt32
        tire_pressure_rl_dT: implementation-data-type=UInt32
        tire_pressure_rr: implementation-data-type=Float
        tire_pressure_rr_status: implementation-data-type=UInt32
        tire_pressure_rr_dT: implementation-data-type=UInt32
        tire_angle_fl: implementation-data-type=Float
        tire_angle_fl_status: implementation-data-type=UInt32
        tire_angle_fl_dT: implementation-data-type=UInt32
        tire_angle_fr: implementation-data-type=Float
        tire_angle_fr_status: implementation-data-type=UInt32
        tire_angle_fr_dT: implementation-data-type=UInt32
        wiper_switch: implementation-data-type=UInt32
        wiper_switch_status: implementation-data-type=UInt32
        wiper_switch_dT: implementation-data-type=UInt32
        wiper_water_switch: implementation-data-type=UInt32
        wiper_water_switch_status: implementation-data-type=UInt32
        wiper_water_switch_dT: implementation-data-type=UInt32
        xbr_extacceldemand: implementation-data-type=Float
        tc1_transreqgear: implementation-data-type=SInt32
        eps_steerangreq: implementation-data-type=Float
    ADMInfoMCU2SOC: category=STRUCTURE
      8 x element, all with category=TYPE_REFERENCE, implementation-data-type=UInt32:
        Rolling_Count
        IDC_Time_L
        IDC_Time_H
        SDC_Time_L
        SDC_Time_H
        adm_admode
        adm_2_pasv_diag
        adm_2_err_diag
    CtrlInfoMCU2SOC: category=STRUCTURE
      67 x element, all with category=TYPE_REFERENCE:
        Rolling_Count: implementation-data-type=UInt32
        IDC_Time_L: implementation-data-type=UInt32
        IDC_Time_H: implementation-data-type=UInt32
        SDC_Time_L: implementation-data-type=UInt32
        SDC_Time_H: implementation-data-type=UInt32
        latctrl_lat_dst_err: implementation-data-type=Float
        latctrl_hding_angl_err: implementation-data-type=Float
        latctrl_latctrl_status: implementation-data-type=Float
        latctrl_proc_tar_str_whl_angl: implementation-data-type=Float
        latctrl_tar_str_whl_angl: implementation-data-type=Float
        latctrl_mpc_tar_yawrate: implementation-data-type=Float
        latctrl_fd_fwd_tar_yawrate: implementation-data-type=Float
        latctrl_tar_yawrate: implementation-data-type=Float
        latctrl_prv_mpc_tar_yawrate: implementation-data-type=Float
        latctrl_prv_fd_fwd_tar_yawrate: implementation-data-type=Float
        latctrl_prv_tar_yawrate: implementation-data-type=Float
        latctrl_fd_str_whl_angl: implementation-data-type=Float
        latctrl_fd_fwd_str_whl_angl: implementation-data-type=Float
        latctrl_yawrate_cps: implementation-data-type=Float
        latctrl_estm_mass_level: implementation-data-type=Float
        latctrl_max_str_whl_angl: implementation-data-type=Float
        latctrl_str_whl_angl_rate: implementation-data-type=Float
        latctrl_road_bump_enable: implementation-data-type=Float
        latctrl_yawrate_controller_p: implementation-data-type=Float
        latctrl_fdbk_amplify_enable: implementation-data-type=Float
        latctrl_equal_wheel_base: implementation-data-type=Float
        latctrl_cur_lat_err_wght: implementation-data-type=Float
        latctrl_cur_hding_err_wght: implementation-data-type=Float
        latctrl_cur_u_wght: implementation-data-type=Float
        latctrl_cur_deltau_wght: implementation-data-type=Float
        latctrl_prv_lat_err_wght: implementation-data-type=Float
        latctrl_prv_hding_wght: implementation-data-type=Float
        latctrl_prv_u_wght: implementation-data-type=Float
        latctrl_prv_deltau_wght: implementation-data-type=Float
        latctrl_fd_fwd_kappa: implementation-data-type=Float
        latctrl_prv_kappa_str_whl_angl: implementation-data-type=Float
        latctrl_prv_fd_fwd_kappa: implementation-data-type=Float
        longctrl_brake_reqd: implementation-data-type=Float
        longctrl_brake_accel_output: implementation-data-type=Float
        longctrl_torque_command_output: implementation-data-type=Float
        longctrl_accel_des: implementation-data-type=Float
        longctrl_accel_limit_max: implementation-data-type=Float
        longctrl_accel_limit_min: implementation-data-type=Float
        longctrl_jerk_limit_max: implementation-data-type=Float
        longctrl_jerk_limit_min: implementation-data-type=Float
        longctrl_p_term_engine: implementation-data-type=Float
        longctrl_i_term_engine: implementation-data-type=Float
        longctrl_p_term_brake: implementation-data-type=Float
        longctrl_i_term_brake: implementation-data-type=Float
        longctrl_long_acc_comp: implementation-data-type=Float
        longctr_speed_comp_longerr: implementation-data-type=Float
        vse_lat_tilt_estmd_angl: implementation-data-type=Float
        vse_estmd_mass: implementation-data-type=Float
        vse_estmd_mass_reliab: implementation-data-type=Float
        crm_lat_err: implementation-data-type=Float
        crm_hding_err: implementation-data-type=Float
        crm_ref_cur: implementation-data-type=Float
        crm_long_err: implementation-data-type=Float
        crm_spd_err: implementation-data-type=Float
        crm_ref_accel: implementation-data-type=Float
        crm_loc_num: implementation-data-type=UInt32
        crm_trj_num: implementation-data-type=UInt32
        crm_lat_ref_indx: implementation-data-type=UInt32
        crm_long_ref_indx: implementation-data-type=UInt32
        adm_admode: implementation-data-type=UInt32
        adm_2_pasv_diag: implementation-data-type=UInt32
        adm_2_err_diag: implementation-data-type=UInt32
    J6L_TxBus: category=STRUCTURE
      82 x element, all with category=TYPE_REFERENCE, implementation-data-type=Float:
        ADU1_ADUBrakeSwitch  # ADU发送的制动开关信号
        ADU1_ADUStat  # 表示ADU实际工作状态。接口说明：VCU接收控制模式为沿变模式， ADU控制需按照周期性发送，且需发送5个连续的控制模式0，然后发送控制模式1.备注：如当前不满足ADU控制模式，（VCU自动驾驶相关状态报文中信号AutoToManualTips会说明不满足的条件），在满足条件后，仍然需要发送5个连续的控制模式0，然后发送控制模式1，才能进入无人模式.
        ADU1_ADUTargetAccel  # Ego truck target acceleration
        ADU1_ADUTargetSpd  # Ego truck target speed
        ADU_Cmd_ADUToBCM  # 该信号表示ADV对BCM的请求控制命令。
        ADU_Cmd_BackBrakeLightCmd  # 该信号表示后制动开关，用于ADV控制BCM点亮后制动灯。
        ADU_Cmd_DrvDoor1UnlockReq  # 该信号表示主驾驶侧车门解闭锁请求，用于ADV控制DCM。
        ADU_Cmd_FrontWasherSwitchCmd  # 该信号表示洗涤开关控制命令，用于ADV控制BCM驱动雨刷。
        ADU_Cmd_FrontWiperSwitchCmd  # 该信号表示雨刮开关控制命令，用于ADV控制BCM驱动雨刮。
        ADU_Cmd_HornCmd  # 该信号用于控制前后喇叭命令。
        ADU_Cmd_PassengerDoor2UnlockReq  # 该信号表示副驾驶侧车门解闭锁请求，用于ADV控制DCM。
        EPB2_AutoDrvState  # 智驾模式
        EPB2_ExtApplyReqForEPB  # External application request for Electronic Parking Brake
        EPB2_ExtInhibitReqForPBApply  # External inhibition request for Parking Brake application
        EPB2_ExtInhibitReqForPBRelease  # External inhibition request for Parking Brake release
        EPB2_ExtPressDemandForEPB  # External pressure demand for Electronic Parking Brake FE: Error FF: Not available
        EPB2_ExtReleaseReqForEPB  # External release request for Electronic Parking Brake
        EPB2_MessageChecksum
        EPB2_MessageCounter  # The message counter is to verify the signal path from the demanding device to the brake controller onelectronic brake systems.
        EPSI1_ExtCtrlModeReq  # 外部控制模式选择 0x0:关闭状态，上电时需要上位机发送此状态 0x1:待机状态，进入外部控制的初始状态。如果需要外部控制，需要上位机首先发送此状态。正常退出外部控制时，需要上位机发此值，让转向机保持ready状态。进行控制模式（手力控制-电机扭矩控制-转角控制）切换时，首先应发送ready使转向机进入ready，然后再发送目标控制模式命令要求转向机进入目标控制模式。 0x2:驾驶员手力矩控制模式，此模式下响应FBFTorqueReq 0x3:电机扭矩控制模式，此模式下响应MotorTorqueReq 0x4:转向角度控制模式，此模式下响应StrgAngleReq 0x5:客户可以发送此命令取消外部控制。一旦外部控制进入取消，上位机需要发送'OFF'→“READY' 来重新进入外部控制。 0x6:外部控制功能锁止，本项目不适用。本项目锁止状态为转向机内部自行判断进入，不响应外部控制信号进入。
        EPSI1_FBFTrqReq  # 驾驶员扭矩需求值
        EPSI1_MessageChecksum  # EPSIx和EPSOx报文的CRC算法： MessageBuffer[0] = EPSI1.byte(0); MessageBuffer[1] = EPSI1.byte(1); MessageBuffer[2] = EPSI1.byte(2); MessageBuffer[3] = EPSI1.byte(3); MessageBuffer[4] = EPSI1.byte(4); MessageBuffer[5] = EPSI1.byte(5); MessageBuffer[6] = EPSI1.byte(6); MessageBuffer[7] = EPSI1.byte(7); Crc8 = CalculateCrc8(MessageBuffer, 0x07, 0x14, 0x9B, 0xFF); //标黄色的0x14是源地址+1，EPS源地址为0x13. byte CalculateCrc8(byte DataArray_u8[], word DataLength_u16, byte StartValueCrc_u8, byte GeneratorPolynom_u8, byte FinalExOr_u8) { word ByteCounter_16 = 0; byte BitCounter_u8 = 0; byte Crc_u8 = 0; Crc_u8 = StartValueCrc_u8; for(ByteCounter_16 = 0; ByteCounter_16
        EPSI1_MessageCounter
        EPSI1_MotorTrqReq  # 电机扭矩需求值
        EPSI1_SteerAngReq  # 转向角度需求值
        EPSI2_ActiveReturnWeightReq  # 主动回正扭矩权重。该信号只用于外部控制中的角度控制模式，其他模式（手力控制/电机扭矩控制）内部默认为0。该信号的设定表征在转角控制时，主动回正功能对最终电机扭矩的影响。
        EPSI2_AngCtrTrqLimReq  # 角度控制扭杆扭矩限值。该扭矩值为最终叠加在扭杆上的扭矩限值，防止在角度控制时扭矩过大导致驾驶员无法在最快的情况下接管方向盘。该信号仅用于外部控制中的角度控制模式，其他模式内部默认为0。
        EPSI2_AngCtrlWeightReq  # 角度控制电机扭矩输出权重请求。通过调整该值可以改变在角度控制时电机扭矩输出的大小。该信号仅用于外部控制中的角度控制模式，其他模式内部默认为0.
        EPSI2_MessageChecksum  # EPSIx和EPSOx报文的CRC算法： MessageBuffer[0] = EPSI1.byte(0); MessageBuffer[1] = EPSI1.byte(1); MessageBuffer[2] = EPSI1.byte(2); MessageBuffer[3] = EPSI1.byte(3); MessageBuffer[4] = EPSI1.byte(4); MessageBuffer[5] = EPSI1.byte(5); MessageBuffer[6] = EPSI1.byte(6); MessageBuffer[7] = EPSI1.byte(7); Crc8 = CalculateCrc8(MessageBuffer, 0x07, 0x14, 0x9B, 0xFF); //标黄色的0x14是源地址+1，控制EPS时ADU作为上位机的源地址为0xE8. byte CalculateCrc8(byte DataArray_u8[], word DataLength_u16, byte StartValueCrc_u8, byte GeneratorPolynom_u8, byte FinalExOr_u8) { word ByteCounter_16 = 0; byte BitCounter_u8 = 0; byte Crc_u8 = 0; Crc_u8 = StartValueCrc_u8; for(ByteCounter_16 = 0; ByteCounter_16
        EPSI2_MessageCounter
        LC_ADU_BackUpLightAndHornCmd  # 倒车灯和蜂鸣器控制
        LC_ADU_HighBeamHeadLightCmd  # 远光灯控制
        LC_ADU_ImplementMarkerLightCmd  # 位置灯、侧标志灯等控制
        LC_ADU_LeftTurnSignalLightsCmd  # 左转向灯控制
        LC_ADU_LowBeamHeadLightCmd  # 近光灯控制
        LC_ADU_RearFogLightCmd  # 后雾灯控制
        LC_ADU_RightTurnSignalLightsCmd  # 右转向灯控制
        LC_ADU_RunLightCmd  # 行车灯
        LC_ADU_TractorFrontFogLightsCmd  # 前雾灯控制
        Lcks_Cmd1_CmdFromExtController  # 1. If desired operating mode is 1 or 2, the scaling of external input Cmd is 16cnt/deg. 2. If desired operation mode is 4,5, or 6, the scaling of external input Cmd is 1024cnt/Nm.Value type: Signed. CAN Range: 0xB380 (Min), 0x4C80 (Max). 1. 如果期望的工作模式是1或2，外部输入命令的缩放是16cnt/deg。 2. 如果需要的操作模式是4、5或6，外部输入命令的缩放是1024cnt/Nm。
        Lcks_Cmd1_DesiredOperateMode  # This is the desired operating mode that another Ctrller wants the ReAX to go. Value type: Unsigned. 有效值是0~6: 0-转向器默认的工作模式 1-自主驾驶模式（外部角度控制模式） 2-转向辅助模式（扭矩叠加模式） 3-辅助电机禁用模式（仅测试使用）
        Lcks_Cmd1_MessageChecksum
        Lcks_Cmd1_MessageCounter  # Same as SPN 3689. The message counter is to verify the signal path from the demanding device to the Strg Ctrller. Thesupport of this parameter is mandatory. Note: The initial value of the 4 bit message counter for the first message during a driving cycle is arbitrary. In every followingmessage the counter is incremented by 1 (0 follows 15).
        TC1_ADU_TransReqGear  # Negative values are reverse gears, positive values are forward gears, zero is neutral.
        TPCM_APCU
        TPCM_DCDC2
        TPCM_PTU
        TPCM_VCU
        TPDT_APCU
        TPDT_DCDC2
        TPDT_PTU
        TPDT_VCU
        TSC1_ACCDR_CtrlPurpose  # Sts signal which indicates which Ctrl mode the sending device is using to generate the TSC1 Cmd. Note that the modes are not in prioritized order. Not all modes may be relevant for a given device. Some devices may not implement all functions. The TSC1 Ctrl purpose shall only apply to messages sent to the Eng. 指示发送设备使用哪种控制模式来生成TSC1命令。注意，这些模式并不是按照优先顺序排列的。并非所有模式都适用于特定设备。有些设备可能不能实现所有的功能。TSC1的控制用途仅适用于发送给发动机的消息。
        TSC1_ACCDR_EngOvrrdCtrlMode  # The override Ctrl mode defines which sort of Cmd is used. 发动机控制模式
        TSC1_ACCDR_EngReqTrqHR  # This parameter displays an additional torque in percent of the reference Eng torque. 发动机扭矩请求的小数部分
        TSC1_ACCDR_EngReqTrqOrTrqLim  # Parameter provided to the Eng or retarder in the torque/speed Ctrl message for Ctrlling or limiting the output torque.Reqed torque to the Eng is measured in indicated torque as a percentage of reference Eng torque. This is the Engtorque at which the Eng is expected to operate if the torque Ctrl mode is active or the Eng torque which the Eng is notexpected to exceed if the torque limit mode is active 在转矩/速度控制信息中提供给发动机或减速机的参数，用于控制或限制输出转矩。要求的发动机转矩是用指示转矩作为参考发动机转矩的百分比来测量的。这是在转矩控制模式为Auto模式时发动机预期运行的发动机转矩，或在转矩限制模式为Auto模式时发动机预期不会超过的发动机转矩
        TSC1_ACCDR_MessageChecksum
        TSC1_ACCDR_MessageCounter  # The message counter is used to detect situations where the transmitting ECU malfunction repeats the same frame all the time.The receiver of the formation may use the counter parameter to detect this situation. The transmitting device will increase themessage counter in every cycle. The message counter will count from 0 to 7 and then wrap. The values 0x8 thru 0xE are SAEreserved and should be ignored by the receiver.Value 0xF (all bits set to 1) will indicate that the message counter is not available.For co
        TSC1_ACCDR_OvrrdCtrlModePriority  # This field is used as an input to the Eng or retarder to determine thepriority of the Override Ctrl Mode received in theTorque/Speed Ctrl message (see PGN 0). The default is 11 (Low priority). It is not required to use the same priority duringthe entire override function. For example, the transmission can use priority 01 (High priority) during a shift, but can set thepriority to 11 (Low priority) at the end of the shift to allow traction Ctrl to also interact with the torque limit of the Eng. 该字段被用作发动机或减速机的输入，以确定在转矩/速度控制消息中接收到的超驰控制模式的优先级(参见PGN 0)。默认值是11(低优先级)。在整个override函数中不需要使用相同的优先级。例如，变速器在换挡时可以使用优先级01(高优先级)，但在换挡结束时可以将优先级设置为11(低优先级)，以便牵引力控制也可以与发动机的扭矩限制相互作用。
        TSC1_ACCDR_ReqSpdCtrlConditions  # This mode tells the Eng Ctrl Sys the governor characteristics that are desired during speed Ctrl. 速度控制时用的 0x0:针对传动系统脱离和非锁定情况进行的瞬态优化 0x1:为传动系统脱离和非锁定条件优化的稳定性 0x2:针对传动系统啮合和/或处于锁定状态1的稳定性进行了优化 0x3:为传动系统啮合和/或处于锁定状态而优化的稳定性2
        TSC1_ACCDR_TransRate  # This parameter indicates the transmission rate at which the sending device will transmit the TSC1 message. The Eng shall Adj its timeout for TSC1 messages accordingly. Variable TSC1 transmission rates shall only apply to messages sent to the Eng. 该参数表示发送设备发送TSC1消息的传输速率。引擎应相应地调整TSC1消息的超时时间。可变的TSC1传输速率仅适用于发送到发动机的消息。
        TSC1_ACCE_CtrlPurpose  # Sts signal which indicates which Ctrl mode the sending device is using to generate the TSC1 Cmd. Note that the modes are not in prioritized order. Not all modes may be relevant for a given device. Some devices may not implement all functions. The TSC1 Ctrl purpose shall only apply to messages sent to the Eng. 指示发送设备使用哪种控制模式来生成TSC1命令。注意，这些模式并不是按照优先顺序排列的。并非所有模式都适用于特定设备。有些设备可能不能实现所有的功能。TSC1的控制用途仅适用于发送给发动机的消息。
        TSC1_ACCE_EngOvrrdCtrlMode  # The override Ctrl mode defines which sort of Cmd is used. 发动机控制模式
        TSC1_ACCE_EngReqTrqHR  # This parameter displays an additional torque in percent of the reference Eng torque. 发动机扭矩请求的小数部分
        TSC1_ACCE_EngReqTrqOrTrqLim  # Parameter provided to the Eng or retarder in the torque/speed Ctrl message for Ctrlling or limiting the output torque.Reqed torque to the Eng is measured in indicated torque as a percentage of reference Eng torque. This is the Engtorque at which the Eng is expected to operate if the torque Ctrl mode is active or the Eng torque which the Eng is notexpected to exceed if the torque limit mode is active 在转矩/速度控制信息中提供给发动机或减速机的参数，用于控制或限制输出转矩。要求的发动机转矩是用指示转矩作为参考发动机转矩的百分比来测量的。这是在转矩控制模式为Auto模式时发动机预期运行的发动机转矩，或在转矩限制模式为Auto模式时发动机预期不会超过的发动机转矩
        TSC1_ACCE_MessageChecksum
        TSC1_ACCE_MessageCounter  # The message counter is used to detect situations where the transmitting ECU malfunction repeats the same frame all the time.The receiver of the formation may use the counter parameter to detect this situation. The transmitting device will increase themessage counter in every cycle. The message counter will count from 0 to 7 and then wrap. The values 0x8 thru 0xE are SAEreserved and should be ignored by the receiver.Value 0xF (all bits set to 1) will indicate that the message counter is not available.For co
        TSC1_ACCE_OvrrdCtrlModePriority  # This field is used as an input to the Eng or retarder to determine thepriority of the Override Ctrl Mode received in theTorque/Speed Ctrl message (see PGN 0). The default is 11 (Low priority). It is not required to use the same priority duringthe entire override function. For example, the transmission can use priority 01 (High priority) during a shift, but can set thepriority to 11 (Low priority) at the end of the shift to allow traction Ctrl to also interact with the torque limit of the Eng. 该字段被用作发动机或减速机的输入，以确定在转矩/速度控制消息中接收到的超驰控制模式的优先级(参见PGN 0)。默认值是11(低优先级)。在整个override函数中不需要使用相同的优先级。例如，变速器在换挡时可以使用优先级01(高优先级)，但在换挡结束时可以将优先级设置为11(低优先级)，以便牵引力控制也可以与发动机的扭矩限制相互作用。
        TSC1_ACCE_ReqSpdCtrlConditions  # This mode tells the Eng Ctrl Sys the governor characteristics that are desired during speed Ctrl. 速度控制时用的 0x0:针对传动系统脱离和非锁定情况进行的瞬态优化 0x1:为传动系统脱离和非锁定条件优化的稳定性 0x2:针对传动系统啮合和/或处于锁定状态1的稳定性进行了优化 0x3:为传动系统啮合和/或处于锁定状态而优化的稳定性2
        TSC1_ACCE_TransRate  # This parameter indicates the transmission rate at which the sending device will transmit the TSC1 message. The Eng shall Adj its timeout for TSC1 messages accordingly. Variable TSC1 transmission rates shall only apply to messages sent to the Eng. 该参数表示发送设备发送TSC1消息的传输速率。引擎应相应地调整TSC1消息的超时时间。可变的TSC1传输速率仅适用于发送到发动机的消息。
        XBR1_CtrlMode  # The XBR Ctrl Mode is used as an input to the Brk Sys and defines how the external Acc demand has to berealized.
        XBR1_EBIMode  # The XBR EBI (Endurance Brk Integration) Mode is used as an input for the Brk Sys to prescribe the use of enduranceBrks like retarders or Eng Brks.
        XBR1_ExtAccelDemand  # Parameter provided to the Brk Sys from external sources. This is the Acc which the Brk Sys is expected torealize. It is specified as an absolute Acc in reference to the road. Pstv values lead to increasing Vhcl speed,Ngtv values lead to decreasing Vhcl speed.Note: Normally only the Ngtv data range is used,but e.g. in case of downhilldriving also Pstv values are possible.
        XBR1_MessageChecksum
        XBR1_MessageCounter  # The XBR message counter is to verify the signal path from the demanding device to the Brk Ctrller on electronic BrkSyss.
        XBR1_Priority  # The XBR Priority is used as an input to the Brk Sys to manage the priority of overlapping external and internal Reqs.
        XBR2_CtrlMode  # The XBR Ctrl Mode is used as an input to the Brk Sys and defines how the external Acc demand has to berealized.
        XBR2_EBIMode  # The XBR EBI (Endurance Brk Integration) Mode is used as an input for the Brk Sys to prescribe the use of enduranceBrks like retarders or Eng Brks.
        XBR2_ExtAccelDemand  # Parameter provided to the Brk Sys from external sources. This is the Acc which the Brk Sys is expected torealize. It is specified as an absolute Acc in reference to the road. Pstv values lead to increasing Vhcl speed,Ngtv values lead to decreasing Vhcl speed.Note: Normally only the Ngtv data range is used,but e.g. in case of downhilldriving also Pstv values are possible.
        XBR2_MessageChecksum
        XBR2_MessageCounter  # The XBR message counter is to verify the signal path from the demanding device to the brakecontroller on electronic brake systems
        XBR2_Priority  # The XBR Priority is used as an input to the Brk Sys to manage the priority of overlapping external and internal Reqs.
    BusLatCtrl: category=STRUCTURE
      element LatCtrl_TarStrWhlAngl: implementation-data-type=Float
      element LatCtrl_StrWhlAnglCtrlActv: implementation-data-type=Boolean
    BusEM: category=STRUCTURE
      element EM_Err: implementation-data-type=Boolean
      element EM_Diag: implementation-data-type=UInt32
    BusCRM: category=STRUCTURE
      8 x element, all with category=TYPE_REFERENCE, implementation-data-type=Float:
        CRM_LatDstErr  # 横向参考距离误差
        CRM_HdingAnglErr  # 横向参考航向误差
        CRM_RefCrvt  # 参考曲率
        CRM_LongDstErr  # 纵向距离误差
        CRM_SpdErr  # 纵向速度误差
        CRM_RefAccel  # 参考加速度
        CRM_RefSlope  # 纵向参考点坡度信息（%）
        CRM_RefSpd  # 纵向参考速度信息
    BusADM: category=STRUCTURE
      element ADM_ADMode: implementation-data-type=UInt8
      element ADM_ADActv: implementation-data-type=Boolean
    BusLongCtrl: category=STRUCTURE
      21 x element, all with category=TYPE_REFERENCE:
        LongCtrl_FinalAccel: implementation-data-type=Float
        LongCtrl_AccelProTerm: implementation-data-type=Float
        LongCtrl_AccelIntgTerm: implementation-data-type=Float
        LongCtrl_TotalSpdErr: implementation-data-type=Float
        LongCtrl_DistPropTerm: implementation-data-type=Float
        LongCtrl_DistIntgTerm: implementation-data-type=Float
        LongCtrl_LongErr: implementation-data-type=Float
        LongCtrl_RefAccel: implementation-data-type=Float
        LongCtrl_SpdErr: implementation-data-type=Float
        LongCtrl_RoadGrdAccel: implementation-data-type=Float
        LongCtrl_AccelLimitMax: implementation-data-type=Float
        LongCtrl_AccelLimitMin: implementation-data-type=Float
        LongCtrl_JerkLimitMax: implementation-data-type=Float
        LongCtrl_JerkLimitMin: implementation-data-type=Float
        LongCtrl_TorqueProTerm: implementation-data-type=Float
        LongCtrl_TorqueIntgTerm: implementation-data-type=Float
        LongCtrl_FeedForward: implementation-data-type=Float
        LongCtrl_TorqueReq: implementation-data-type=Float
        LongCtrl_BrakeAccel: implementation-data-type=Float
        LongCtrl_SpdComp: implementation-data-type=Float
        LongCtrl_BrakeReqd: implementation-data-type=UInt8
    BusVSE: category=STRUCTURE
      20 x element, all with category=TYPE_REFERENCE:
        VSE_LatTiltEstmdAngl: implementation-data-type=Float
        VSE_EstmdMass: implementation-data-type=Float
        VSE_EstmdMassReliab: implementation-data-type=Boolean
        VSE_LonTiltEstmdAngl: implementation-data-type=Float
        x: implementation-data-type=Double  # 位置x坐标
        y: implementation-data-type=Double  # 位置y坐标
        z: implementation-data-type=Double  # 位置z坐标
        com_x: implementation-data-type=Double  # 质心x
        com_y: implementation-data-type=Double  # 质心位置y
        com_z: implementation-data-type=Double  # 质心位置
        timestamp: implementation-data-type=Double  # 当前时间
        roll: implementation-data-type=Double  # roll角
        pitch: implementation-data-type=Double  # pitch角
        heading: implementation-data-type=Double  # heading角
        kappa: implementation-data-type=Double  # 车辆当前曲率
        linear_velocity: implementation-data-type=Double  # 线速度
        angular_velocity: implementation-data-type=Double  # 角速度
        linear_acceleration: implementation-data-type=Double  # 线加速度
        gear: implementation-data-type=SInt8  # GEAR_NEUTRAL = 0, GEAR_DRIVE = 1, GEAR_REVERSE = 2, GEAR_PARKING = 3, GEAR_NONE = 4, GEAR_INVALID = 5,
        driving_mode: implementation-data-type=UInt8  # COMPLETE_MANUAL = 0, COMPLETE_AUTO_DRIVE = 1, AUTO_STEER_ONLY = 2, AUTO_SPEED_ONLY = 3, EMERGENCY_MODE = 4,
    Double_const: category=VALUE, base-type=float64, additional-native-type-qualifier=const
    Float_const: category=VALUE, base-type=float32, additional-native-type-qualifier=const
    rt_Array_Float_22: category=ARRAY
      element rt_Array_Float_22: array-size=22, array-size-semantics=FIXED-SIZE, implementation-data-type=Float
    rt_Array_Float_22_const: category=ARRAY, additional-native-type-qualifier=const
      element rt_Array_Float_22_const: array-size=22, array-size-semantics=FIXED-SIZE, implementation-data-type=Float
    rt_Array_Float_292: category=ARRAY
      element rt_Array_Float_292: array-size=292, array-size-semantics=FIXED-SIZE, implementation-data-type=Float
    rt_Array_Float_292_const: category=ARRAY, additional-native-type-qualifier=const
      element rt_Array_Float_292_const: array-size=292, array-size-semantics=FIXED-SIZE, implementation-data-type=Float
    rt_Array_Float_25: category=ARRAY
      element rt_Array_Float_25: array-size=25, array-size-semantics=FIXED-SIZE, implementation-data-type=Float
    rt_Array_Float_25_const: category=ARRAY, additional-native-type-qualifier=const
      element rt_Array_Float_25_const: array-size=25, array-size-semantics=FIXED-SIZE, implementation-data-type=Float
    rt_Array_Float_7: category=ARRAY
      element rt_Array_Float_7: array-size=7, array-size-semantics=FIXED-SIZE, implementation-data-type=Float
    rt_Array_Float_7_const: category=ARRAY, additional-native-type-qualifier=const
      element rt_Array_Float_7_const: array-size=7, array-size-semantics=FIXED-SIZE, implementation-data-type=Float
    rt_Array_Float_5: category=ARRAY
      element rt_Array_Float_5: array-size=5, array-size-semantics=FIXED-SIZE, implementation-data-type=Float
    rt_Array_Float_5_const: category=ARRAY, additional-native-type-qualifier=const
      element rt_Array_Float_5_const: array-size=5, array-size-semantics=FIXED-SIZE, implementation-data-type=Float
    rt_Array_Float_2: category=ARRAY
      element rt_Array_Float_2: array-size=2, array-size-semantics=FIXED-SIZE, implementation-data-type=Float
    rt_Array_Float_2_const: category=ARRAY, additional-native-type-qualifier=const
      element rt_Array_Float_2_const: array-size=2, array-size-semantics=FIXED-SIZE, implementation-data-type=Float
    rt_Array_Float_9: category=ARRAY
      element rt_Array_Float_9: array-size=9, array-size-semantics=FIXED-SIZE, implementation-data-type=Float
    rt_Array_Float_9_const: category=ARRAY, additional-native-type-qualifier=const
      element rt_Array_Float_9_const: array-size=9, array-size-semantics=FIXED-SIZE, implementation-data-type=Float
    rt_Array_Float_8: category=ARRAY
      element rt_Array_Float_8: array-size=8, array-size-semantics=FIXED-SIZE, implementation-data-type=Float
    rt_Array_Float_8_const: category=ARRAY, additional-native-type-qualifier=const
      element rt_Array_Float_8_const: array-size=8, array-size-semantics=FIXED-SIZE, implementation-data-type=Float
    UInt16_const: category=VALUE, base-type=uint16, additional-native-type-qualifier=const
    Boolean_const: category=VALUE, base-type=boolean, compu {0=FALSE, 1=TRUE}, additional-native-type-qualifier=const
    UInt8_const: category=VALUE, base-type=uint8, additional-native-type-qualifier=const
package /DataTypes/Constants
  122 x constant specification:
    k_CRM_LatCrvtPrvTi: value-spec=k_CRM_LatCrvtPrvTi:0.5
    k_CRM_LatErrPrvTi: value-spec=k_CRM_LatErrPrvTi:0
    k_CRM_LongPrvTi: value-spec=k_CRM_LongPrvTi:0.2
    k_Lat_SteerAnglErrDisThres: value-spec=k_Lat_SteerAnglErrDisThres:0.1
    k_Lat_SteerAnglOffsetIni: value-spec=k_Lat_SteerAnglOffsetIni:-25
    k_Lat_SteerAngloffsetAnglThres: value-spec=k_Lat_SteerAngloffsetAnglThres:5
    k_Lat_SteerAngloffsetHidingErrThres: value-spec=k_Lat_SteerAngloffsetHidingErrThres:0.005
    k_Lat_SteerAngloffsetHoldTi: value-spec=k_Lat_SteerAngloffsetHoldTi:30
    k_Lat_SteerAngloffsetLatErrThres: value-spec=k_Lat_SteerAngloffsetLatErrThres:0.02
    k_Lat_SteerAngloffsetWaitTi: value-spec=k_Lat_SteerAngloffsetWaitTi:5
    k_SigMap_brake_accel_deadzone: value-spec=k_SigMap_brake_accel_deadzone:-0.2
    k_CRM_DstErrCalibration: value-spec=k_CRM_DstErrCalibration:0
    k_CRM_LongRefAccCalibration: value-spec=k_CRM_LongRefAccCalibration:0
    k_CRM_LongRefSpdCalibration: value-spec=k_CRM_LongRefSpdCalibration:5
    k_EPS_StrAnglGain: value-spec=k_EPS_StrAnglGain:1
    k_Lat_DefaultCmd: value-spec=k_Lat_DefaultCmd:0
    k_Lat_DeltaFeedbackStrWhlAngUp: value-spec=k_Lat_DeltaFeedbackStrWhlAngUp:[k_Lat_DeltaFeedbackStrWhlAngUp_rt_Array_Float_22_1:4, k_Lat_DeltaFeedbackStrWhlAngUp_rt_Array_Float_22_2:4, k_Lat_DeltaFeedbackStrWhlAngUp_rt_Array_Float_22_3:4, k_Lat_DeltaFeedbackStrWhlAngUp_rt_Array_Float_22_4:4, k_Lat_DeltaFeedbackStrWhlAngUp_rt_Array_Float_22_5:4, k_Lat_DeltaFeedbackStrWhlAngUp_rt_Array_Float_22_6:3.6, k_Lat_DeltaFeedbackStrWhlAngUp_rt_Array_Float_22_7:3.2, k_Lat_DeltaFeedbackStrWhlAngUp_rt_Array_Float_22_8:2.8, k_Lat_DeltaFeedbackStrWhlAngUp_rt_Array_Float_22_9:2.4, k_Lat_DeltaFeedbackStrWhlAngUp_rt_Array_Float_22_10:2.2, k_Lat_DeltaFeedbackStrWhlAngUp_rt_Array_Float_22_11:2, k_Lat_DeltaFeedbackStrWhlAngUp_rt_Array_Float_22_12:1.8, k_Lat_DeltaFeedbackStrWhlAngUp_rt_Array_Float_22_13:1.6, k_Lat_DeltaFeedbackStrWhlAngUp_rt_Array_Float_22_14:1.4, k_Lat_DeltaFeedbackStrWhlAngUp_rt_Array_Float_22_15:1.2, k_Lat_DeltaFeedbackStrWhlAngUp_rt_Array_Float_22_16:1, k_Lat_DeltaFeedbackStrWhlAngUp_rt_Array_Float_22_17:0.8, k_Lat_DeltaFeedbackStrWhlAngUp_rt_Array_Float_22_18:0.8, k_Lat_DeltaFeedbackStrWhlAngUp_rt_Array_Float_22_19:0.8, k_Lat_DeltaFeedbackStrWhlAngUp_rt_Array_Float_22_20:0.8, k_Lat_DeltaFeedbackStrWhlAngUp_rt_Array_Float_22_21:0.8, k_Lat_DeltaFeedbackStrWhlAngUp_rt_Array_Float_22_22:0.8]
    k_Lat_DeltaFeedbackStrWhlAngUpUturn: value-spec=k_Lat_DeltaFeedbackStrWhlAngUpUturn:6
    k_Lat_DeltaFeedforwardStrWhlAngUp: value-spec=k_Lat_DeltaFeedforwardStrWhlAngUp:[k_Lat_DeltaFeedforwardStrWhlAngUp_rt_Array_Float_22_1:6, k_Lat_DeltaFeedforwardStrWhlAngUp_rt_Array_Float_22_2:6, k_Lat_DeltaFeedforwardStrWhlAngUp_rt_Array_Float_22_3:6, k_Lat_DeltaFeedforwardStrWhlAngUp_rt_Array_Float_22_4:6, k_Lat_DeltaFeedforwardStrWhlAngUp_rt_Array_Float_22_5:4, k_Lat_DeltaFeedforwardStrWhlAngUp_rt_Array_Float_22_6:3, k_Lat_DeltaFeedforwardStrWhlAngUp_rt_Array_Float_22_7:3, k_Lat_DeltaFeedforwardStrWhlAngUp_rt_Array_Float_22_8:2, k_Lat_DeltaFeedforwardStrWhlAngUp_rt_Array_Float_22_9:2, k_Lat_DeltaFeedforwardStrWhlAngUp_rt_Array_Float_22_10:1.2, k_Lat_DeltaFeedforwardStrWhlAngUp_rt_Array_Float_22_11:1, k_Lat_DeltaFeedforwardStrWhlAngUp_rt_Array_Float_22_12:1, k_Lat_DeltaFeedforwardStrWhlAngUp_rt_Array_Float_22_13:1, k_Lat_DeltaFeedforwardStrWhlAngUp_rt_Array_Float_22_14:1, k_Lat_DeltaFeedforwardStrWhlAngUp_rt_Array_Float_22_15:1, k_Lat_DeltaFeedforwardStrWhlAngUp_rt_Array_Float_22_16:1, k_Lat_DeltaFeedforwardStrWhlAngUp_rt_Array_Float_22_17:1, k_Lat_DeltaFeedforwardStrWhlAngUp_rt_Array_Float_22_18:1, k_Lat_DeltaFeedforwardStrWhlAngUp_rt_Array_Float_22_19:1, k_Lat_DeltaFeedforwardStrWhlAngUp_rt_Array_Float_22_20:1, k_Lat_DeltaFeedforwardStrWhlAngUp_rt_Array_Float_22_21:1, k_Lat_DeltaFeedforwardStrWhlAngUp_rt_Array_Float_22_22:1]
    k_Lat_DeltaFeedforwardStrWhlAngUpUturn: value-spec=k_Lat_DeltaFeedforwardStrWhlAngUpUturn:6
    k_Lat_DeltaStrWhlAngUp: value-spec=k_Lat_DeltaStrWhlAngUp:[k_Lat_DeltaStrWhlAngUp_rt_Array_Float_22_1:8, k_Lat_DeltaStrWhlAngUp_rt_Array_Float_22_2:8, k_Lat_DeltaStrWhlAngUp_rt_Array_Float_22_3:8, k_Lat_DeltaStrWhlAngUp_rt_Array_Float_22_4:8, k_Lat_DeltaStrWhlAngUp_rt_Array_Float_22_5:6, k_Lat_DeltaStrWhlAngUp_rt_Array_Float_22_6:4, k_Lat_DeltaStrWhlAngUp_rt_Array_Float_22_7:4, k_Lat_DeltaStrWhlAngUp_rt_Array_Float_22_8:4, k_Lat_DeltaStrWhlAngUp_rt_Array_Float_22_9:4, k_Lat_DeltaStrWhlAngUp_rt_Array_Float_22_10:4, k_Lat_DeltaStrWhlAngUp_rt_Array_Float_22_11:4, k_Lat_DeltaStrWhlAngUp_rt_Array_Float_22_12:2, k_Lat_DeltaStrWhlAngUp_rt_Array_Float_22_13:2, k_Lat_DeltaStrWhlAngUp_rt_Array_Float_22_14:2, k_Lat_DeltaStrWhlAngUp_rt_Array_Float_22_15:1, k_Lat_DeltaStrWhlAngUp_rt_Array_Float_22_16:1, k_Lat_DeltaStrWhlAngUp_rt_Array_Float_22_17:1, k_Lat_DeltaStrWhlAngUp_rt_Array_Float_22_18:1, k_Lat_DeltaStrWhlAngUp_rt_Array_Float_22_19:1, k_Lat_DeltaStrWhlAngUp_rt_Array_Float_22_20:1, k_Lat_DeltaStrWhlAngUp_rt_Array_Float_22_21:1, k_Lat_DeltaStrWhlAngUp_rt_Array_Float_22_22:1]
    k_Lat_DeltaStrWhlAngUpUturn: value-spec=k_Lat_DeltaStrWhlAngUpUturn:6
    k_Lat_DeltaStrWhlAnglforBias: value-spec=k_Lat_DeltaStrWhlAnglforBias:0.2
    k_Lat_DuWeight: value-spec=k_Lat_DuWeight:1
    k_Lat_FbResetVxThd: value-spec=k_Lat_FbResetVxThd:0.5
    k_Lat_LQR_HeadingError_Weights: value-spec=k_Lat_LQR_HeadingError_Weights:[k_Lat_LQR_HeadingError_Weights_rt_Array_Float_22_1:0.1, k_Lat_LQR_HeadingError_Weights_rt_Array_Float_22_2:0.1, k_Lat_LQR_HeadingError_Weights_rt_Array_Float_22_3:0.1, k_Lat_LQR_HeadingError_Weights_rt_Array_Float_22_4:0.3, k_Lat_LQR_HeadingError_Weights_rt_Array_Float_22_5:0.3, k_Lat_LQR_HeadingError_Weights_rt_Array_Float_22_6:0.3, k_Lat_LQR_HeadingError_Weights_rt_Array_Float_22_7:0.4, k_Lat_LQR_HeadingError_Weights_rt_Array_Float_22_8:0.5, k_Lat_LQR_HeadingError_Weights_rt_Array_Float_22_9:0.6, k_Lat_LQR_HeadingError_Weights_rt_Array_Float_22_10:0.6, k_Lat_LQR_HeadingError_Weights_rt_Array_Float_22_11:0.8, k_Lat_LQR_HeadingError_Weights_rt_Array_Float_22_12:0.8, k_Lat_LQR_HeadingError_Weights_rt_Array_Float_22_13:0.8, k_Lat_LQR_HeadingError_Weights_rt_Array_Float_22_14:0.8, k_Lat_LQR_HeadingError_Weights_rt_Array_Float_22_15:0.8, k_Lat_LQR_HeadingError_Weights_rt_Array_Float_22_16:0.8, k_Lat_LQR_HeadingError_Weights_rt_Array_Float_22_17:0.8, k_Lat_LQR_HeadingError_Weights_rt_Array_Float_22_18:0.8, k_Lat_LQR_HeadingError_Weights_rt_Array_Float_22_19:0.8, k_Lat_LQR_HeadingError_Weights_rt_Array_Float_22_20:0.8, k_Lat_LQR_HeadingError_Weights_rt_Array_Float_22_21:0.8, k_Lat_LQR_HeadingError_Weights_rt_Array_Float_22_22:0.8]
    k_Lat_LQR_K_Matrics: value-spec=k_Lat_LQR_K_Matrics:[k_Lat_LQR_K_Matrics_rt_Array_Float_292_1:0.3109462, k_Lat_LQR_K_Matrics_rt_Array_Float_292_2:0.3109462, k_Lat_LQR_K_Matrics_rt_Array_Float_292_3:0.3109462, k_Lat_LQR_K_Matrics_rt_Array_Float_292_4:0.3109462, k_Lat_LQR_K_Matrics_rt_Array_Float_292_5:0.3109462, k_Lat_LQR_K_Matrics_rt_Array_Float_292_6:0.3109462, k_Lat_LQR_K_Matrics_rt_Array_Float_292_7:0.3109462, k_Lat_LQR_K_Matrics_rt_Array_Float_292_8:0.3109462, k_Lat_LQR_K_Matrics_rt_Array_Float_292_9:0.3391505, k_Lat_LQR_K_Matrics_rt_Array_Float_292_10:0.3323743, k_Lat_LQR_K_Matrics_rt_Array_Float_292_11:0.3164925, k_Lat_LQR_K_Matrics_rt_Array_Float_292_12:0.2923818, k_Lat_LQR_K_Matrics_rt_Array_Float_292_13:0.2602756, k_Lat_LQR_K_Matrics_rt_Array_Float_292_14:0.2724153, k_Lat_LQR_K_Matrics_rt_Array_Float_292_15:0.2821887, k_Lat_LQR_K_Matrics_rt_Array_Float_292_16:0.289842, k_Lat_LQR_K_Matrics_rt_Array_Float_292_17:0.2956633, k_Lat_LQR_K_Matrics_rt_Array_Float_292_18:0.2999507, k_Lat_LQR_K_Matrics_rt_Array_Float_292_19:0.3029923, k_Lat_LQR_K_Matrics_rt_Array_Float_292_20:0.30505, k_Lat_LQR_K_Matrics_rt_Array_Float_292_21:0.3063528, k_Lat_LQR_K_Matrics_rt_Array_Float_292_22:0.3064596, k_Lat_LQR_K_Matrics_rt_Array_Float_292_23:0.3065124, k_Lat_LQR_K_Matrics_rt_Array_Float_292_24:0.3065213, k_Lat_LQR_K_Matrics_rt_Array_Float_292_25:0.3064956, k_Lat_LQR_K_Matrics_rt_Array_Float_292_26:0.3064421, k_Lat_LQR_K_Matrics_rt_Array_Float_292_27:0.3063683, k_Lat_LQR_K_Matrics_rt_Array_Float_292_28:0.30628, k_Lat_LQR_K_Matrics_rt_Array_Float_292_29:0.3061822, k_Lat_LQR_K_Matrics_rt_Array_Float_292_30:0.3060792, k_Lat_LQR_K_Matrics_rt_Array_Float_292_31:0.3059751, k_Lat_LQR_K_Matrics_rt_Array_Float_292_32:0.2930523, k_Lat_LQR_K_Matrics_rt_Array_Float_292_33:0.2795085, k_Lat_LQR_K_Matrics_rt_Array_Float_292_34:0.2652346, k_Lat_LQR_K_Matrics_rt_Array_Float_292_35:0.2500833, k_Lat_LQR_K_Matrics_rt_Array_Float_292_36:0.2338648, k_Lat_LQR_K_Matrics_rt_Array_Float_292_37:0.2163109, k_Lat_LQR_K_Matrics_rt_Array_Float_292_38:0.1970398, k_Lat_LQR_K_Matrics_rt_Array_Float_292_39:0.1754784, k_Lat_LQR_K_Matrics_rt_Array_Float_292_40:0.1507263, k_Lat_LQR_K_Matrics_rt_Array_Float_292_41:0.1212595, k_Lat_LQR_K_Matrics_rt_Array_Float_292_42:0.1216296, k_Lat_LQR_K_Matrics_rt_Array_Float_292_43:0.1219835, k_Lat_LQR_K_Matrics_rt_Array_Float_292_44:0.1223225, k_Lat_LQR_K_Matrics_rt_Array_Float_292_45:0.1226475, k_Lat_LQR_K_Matrics_rt_Array_Float_292_46:0.1229603, k_Lat_LQR_K_Matrics_rt_Array_Float_292_47:0.1232616, k_Lat_LQR_K_Matrics_rt_Array_Float_292_48:0.1235523, k_Lat_LQR_K_Matrics_rt_Array_Float_292_49:0.1238334, k_Lat_LQR_K_Matrics_rt_Array_Float_292_50:0.1241059, k_Lat_LQR_K_Matrics_rt_Array_Float_292_51:0.1243704, k_Lat_LQR_K_Matrics_rt_Array_Float_292_52:0.1248337, k_Lat_LQR_K_Matrics_rt_Array_Float_292_53:0.125281, k_Lat_LQR_K_Matrics_rt_Array_Float_292_54:0.1257129, k_Lat_LQR_K_Matrics_rt_Array_Float_292_55:0.12613, k_Lat_LQR_K_Matrics_rt_Array_Float_292_56:0.1265333, k_Lat_LQR_K_Matrics_rt_Array_Float_292_57:0.1269225, k_Lat_LQR_K_Matrics_rt_Array_Float_292_58:0.1272986, k_Lat_LQR_K_Matrics_rt_Array_Float_292_59:0.1276621, k_Lat_LQR_K_Matrics_rt_Array_Float_292_60:0.1280133, k_Lat_LQR_K_Matrics_rt_Array_Float_292_61:0.1283529, k_Lat_LQR_K_Matrics_rt_Array_Float_292_62:0.1071824, k_Lat_LQR_K_Matrics_rt_Array_Float_292_63:0.1102359, k_Lat_LQR_K_Matrics_rt_Array_Float_292_64:0.1126334, k_Lat_LQR_K_Matrics_rt_Array_Float_292_65:0.1145076, k_Lat_LQR_K_Matrics_rt_Array_Float_292_66:0.1159649, k_Lat_LQR_K_Matrics_rt_Array_Float_292_67:0.1170912, k_Lat_LQR_K_Matrics_rt_Array_Float_292_68:0.1179558, k_Lat_LQR_K_Matrics_rt_Array_Float_292_69:0.1186145, k_Lat_LQR_K_Matrics_rt_Array_Float_292_70:0.1191118, k_Lat_LQR_K_Matrics_rt_Array_Float_292_71:0.1194831, k_Lat_LQR_K_Matrics_rt_Array_Float_292_72:0.1197567, k_Lat_LQR_K_Matrics_rt_Array_Float_292_73:0.119955, k_Lat_LQR_K_Matrics_rt_Array_Float_292_74:0.006640004, k_Lat_LQR_K_Matrics_rt_Array_Float_292_75:0.006640004, k_Lat_LQR_K_Matrics_rt_Array_Float_292_76:0.006640004, k_Lat_LQR_K_Matrics_rt_Array_Float_292_77:0.006640004, k_Lat_LQR_K_Matrics_rt_Array_Float_292_78:0.006640004, k_Lat_LQR_K_Matrics_rt_Array_Float_292_79:0.006640004, k_Lat_LQR_K_Matrics_rt_Array_Float_292_80:0.006640004, k_Lat_LQR_K_Matrics_rt_Array_Float_292_81:0.006640004, k_Lat_LQR_K_Matrics_rt_Array_Float_292_82:0.008169973, k_Lat_LQR_K_Matrics_rt_Array_Float_292_83:0.009276875, k_Lat_LQR_K_Matrics_rt_Array_Float_292_84:0.01012071, k_Lat_LQR_K_Matrics_rt_Array_Float_292_85:0.01063408, k_Lat_LQR_K_Matrics_rt_Array_Float_292_86:0.01073735, k_Lat_LQR_K_Matrics_rt_Array_Float_292_87:0.01230856, k_Lat_LQR_K_Matrics_rt_Array_Float_292_88:0.01386802, k_Lat_LQR_K_Matrics_rt_Array_Float_292_89:0.01539792, k_Lat_LQR_K_Matrics_rt_Array_Float_292_90:0.0168862, k_Lat_LQR_K_Matrics_rt_Array_Float_292_91:0.01832576, k_Lat_LQR_K_Matrics_rt_Array_Float_292_92:0.01971352, k_Lat_LQR_K_Matrics_rt_Array_Float_292_93:0.02104966, k_Lat_LQR_K_Matrics_rt_Array_Float_292_94:0.02233634, k_Lat_LQR_K_Matrics_rt_Array_Float_292_95:0.02284453, k_Lat_LQR_K_Matrics_rt_Array_Float_292_96:0.0233463, k_Lat_LQR_K_Matrics_rt_Array_Float_292_97:0.02384198, k_Lat_LQR_K_Matrics_rt_Array_Float_292_98:0.02433196, k_Lat_LQR_K_Matrics_rt_Array_Float_292_99:0.02481667, k_Lat_LQR_K_Matrics_rt_Array_Float_292_100:0.02529637, k_Lat_LQR_K_Matrics_rt_Array_Float_292_101:0.02577148, k_Lat_LQR_K_Matrics_rt_Array_Float_292_102:0.02624231, k_Lat_LQR_K_Matrics_rt_Array_Float_292_103:0.02670918, k_Lat_LQR_K_Matrics_rt_Array_Float_292_104:0.02717237, k_Lat_LQR_K_Matrics_rt_Array_Float_292_105:0.02675927, k_Lat_LQR_K_Matrics_rt_Array_Float_292_106:0.02627055, k_Lat_LQR_K_Matrics_rt_Array_Float_292_107:0.0256949, k_Lat_LQR_K_Matrics_rt_Array_Float_292_108:0.02501738, k_Lat_LQR_K_Matrics_rt_Array_Float_292_109:0.02421808, k_Lat_LQR_K_Matrics_rt_Array_Float_292_110:0.02326939, k_Lat_LQR_K_Matrics_rt_Array_Float_292_111:0.02213165, k_Lat_LQR_K_Matrics_rt_Array_Float_292_112:0.02074537, k_Lat_LQR_K_Matrics_rt_Array_Float_292_113:0.01901704, k_Lat_LQR_K_Matrics_rt_Array_Float_292_114:0.0167884, k_Lat_LQR_K_Matrics_rt_Array_Float_292_115:0.01711366, k_Lat_LQR_K_Matrics_rt_Array_Float_292_116:0.01743634, k_Lat_LQR_K_Matrics_rt_Array_Float_292_117:0.01775667, k_Lat_LQR_K_Matrics_rt_Array_Float_292_118:0.01807468, k_Lat_LQR_K_Matrics_rt_Array_Float_292_119:0.01839031, k_Lat_LQR_K_Matrics_rt_Array_Float_292_120:0.01870374, k_Lat_LQR_K_Matrics_rt_Array_Float_292_121:0.01901499, k_Lat_LQR_K_Matrics_rt_Array_Float_292_122:0.01932403, k_Lat_LQR_K_Matrics_rt_Array_Float_292_123:0.01963107, k_Lat_LQR_K_Matrics_rt_Array_Float_292_124:0.01993607, k_Lat_LQR_K_Matrics_rt_Array_Float_292_125:0.02021992, k_Lat_LQR_K_Matrics_rt_Array_Float_292_126:0.0205017, k_Lat_LQR_K_Matrics_rt_Array_Float_292_127:0.02078153, k_Lat_LQR_K_Matrics_rt_Array_Float_292_128:0.02105932, k_Lat_LQR_K_Matrics_rt_Array_Float_292_129:0.02133511, k_Lat_LQR_K_Matrics_rt_Array_Float_292_130:0.02160894, k_Lat_LQR_K_Matrics_rt_Array_Float_292_131:0.02188079, k_Lat_LQR_K_Matrics_rt_Array_Float_292_132:0.02215074, k_Lat_LQR_K_Matrics_rt_Array_Float_292_133:0.02241871, k_Lat_LQR_K_Matrics_rt_Array_Float_292_134:0.02268467, k_Lat_LQR_K_Matrics_rt_Array_Float_292_135:0.02326464, k_Lat_LQR_K_Matrics_rt_Array_Float_292_136:0.02554457, k_Lat_LQR_K_Matrics_rt_Array_Float_292_137:0.02768094, k_Lat_LQR_K_Matrics_rt_Array_Float_292_138:0.02967829, k_Lat_LQR_K_Matrics_rt_Array_Float_292_139:0.03154297, k_Lat_LQR_K_Matrics_rt_Array_Float_292_140:0.03328226, k_Lat_LQR_K_Matrics_rt_Array_Float_292_141:0.03490416, k_Lat_LQR_K_Matrics_rt_Array_Float_292_142:0.0364167, k_Lat_LQR_K_Matrics_rt_Array_Float_292_143:0.03782824, k_Lat_LQR_K_Matrics_rt_Array_Float_292_144:0.03914665, k_Lat_LQR_K_Matrics_rt_Array_Float_292_145:0.04037976, k_Lat_LQR_K_Matrics_rt_Array_Float_292_146:0.04153445, k_Lat_LQR_K_Matrics_rt_Array_Float_292_147:0.4621465, k_Lat_LQR_K_Matrics_rt_Array_Float_292_148:0.4621465, k_Lat_LQR_K_Matrics_rt_Array_Float_292_149:0.4621465, k_Lat_LQR_K_Matrics_rt_Array_Float_292_150:0.4621465, k_Lat_LQR_K_Matrics_rt_Array_Float_292_151:0.4621465, k_Lat_LQR_K_Matrics_rt_Array_Float_292_152:0.4621465, k_Lat_LQR_K_Matrics_rt_Array_Float_292_153:0.4621465, k_Lat_LQR_K_Matrics_rt_Array_Float_292_154:0.4621465, k_Lat_LQR_K_Matrics_rt_Array_Float_292_155:0.5505068, k_Lat_LQR_K_Matrics_rt_Array_Float_292_156:0.6279265, k_Lat_LQR_K_Matrics_rt_Array_Float_292_157:0.6884665, k_Lat_LQR_K_Matrics_rt_Array_Float_292_158:0.7301068, k_Lat_LQR_K_Matrics_rt_Array_Float_292_159:0.7508383, k_Lat_LQR_K_Matrics_rt_Array_Float_292_160:0.8203741, k_Lat_LQR_K_Matrics_rt_Array_Float_292_161:0.8835881, k_Lat_LQR_K_Matrics_rt_Array_Float_292_162:0.9400339, k_Lat_LQR_K_Matrics_rt_Array_Float_292_163:0.9896708, k_Lat_LQR_K_Matrics_rt_Array_Float_292_164:1.0327458, k_Lat_LQR_K_Matrics_rt_Array_Float_292_165:1.0696832, k_Lat_LQR_K_Matrics_rt_Array_Float_292_166:1.1010716, k_Lat_LQR_K_Matrics_rt_Array_Float_292_167:1.127529, k_Lat_LQR_K_Matrics_rt_Array_Float_292_168:1.1396607, k_Lat_LQR_K_Matrics_rt_Array_Float_292_169:1.1510487, k_Lat_LQR_K_Matrics_rt_Array_Float_292_170:1.161743, k_Lat_LQR_K_Matrics_rt_Array_Float_292_171:1.1717844, k_Lat_LQR_K_Matrics_rt_Array_Float_292_172:1.1812321, k_Lat_LQR_K_Matrics_rt_Array_Float_292_173:1.1901232, k_Lat_LQR_K_Matrics_rt_Array_Float_292_174:1.1984953, k_Lat_LQR_K_Matrics_rt_Array_Float_292_175:1.2064034, k_Lat_LQR_K_Matrics_rt_Array_Float_292_176:1.2138776, k_Lat_LQR_K_Matrics_rt_Array_Float_292_177:1.2209574, k_Lat_LQR_K_Matrics_rt_Array_Float_292_178:1.2086118, k_Lat_LQR_K_Matrics_rt_Array_Float_292_179:1.1946036, k_Lat_LQR_K_Matrics_rt_Array_Float_292_180:1.1786054, k_Lat_LQR_K_Matrics_rt_Array_Float_292_181:1.1601913, k_Lat_LQR_K_Matrics_rt_Array_Float_292_182:1.1387479, k_Lat_LQR_K_Matrics_rt_Array_Float_292_183:1.1134534, k_Lat_LQR_K_Matrics_rt_Array_Float_292_184:1.0830806, k_Lat_LQR_K_Matrics_rt_Array_Float_292_185:1.0457884, k_Lat_LQR_K_Matrics_rt_Array_Float_292_186:0.9986312, k_Lat_LQR_K_Matrics_rt_Array_Float_292_187:0.9366311, k_Lat_LQR_K_Matrics_rt_Array_Float_292_188:0.945668, k_Lat_LQR_K_Matrics_rt_Array_Float_292_189:0.9543856, k_Lat_LQR_K_Matrics_rt_Array_Float_292_190:0.9628106, k_Lat_LQR_K_Matrics_rt_Array_Float_292_191:0.9709616, k_Lat_LQR_K_Matrics_rt_Array_Float_292_192:0.9788343, k_Lat_LQR_K_Matrics_rt_Array_Float_292_193:0.9864575, k_Lat_LQR_K_Matrics_rt_Array_Float_292_194:0.9938428, k_Lat_LQR_K_Matrics_rt_Array_Float_292_195:1.0009925, k_Lat_LQR_K_Matrics_rt_Array_Float_292_196:1.0079329, k_Lat_LQR_K_Matrics_rt_Array_Float_292_197:1.0146648, k_Lat_LQR_K_Matrics_rt_Array_Float_292_198:1.017663, k_Lat_LQR_K_Matrics_rt_Array_Float_292_199:1.0205462, k_Lat_LQR_K_Matrics_rt_Array_Float_292_200:1.023326, k_Lat_LQR_K_Matrics_rt_Array_Float_292_201:1.0260012, k_Lat_LQR_K_Matrics_rt_Array_Float_292_202:1.0285686, k_Lat_LQR_K_Matrics_rt_Array_Float_292_203:1.0310494, k_Lat_LQR_K_Matrics_rt_Array_Float_292_204:1.0334435, k_Lat_LQR_K_Matrics_rt_Array_Float_292_205:1.0357468, k_Lat_LQR_K_Matrics_rt_Array_Float_292_206:1.0379703, k_Lat_LQR_K_Matrics_rt_Array_Float_292_207:1.04011, k_Lat_LQR_K_Matrics_rt_Array_Float_292_208:1.0754204, k_Lat_LQR_K_Matrics_rt_Array_Float_292_209:1.0865747, k_Lat_LQR_K_Matrics_rt_Array_Float_292_210:1.0952551, k_Lat_LQR_K_Matrics_rt_Array_Float_292_211:1.1021957, k_Lat_LQR_K_Matrics_rt_Array_Float_292_212:1.1078804, k_Lat_LQR_K_Matrics_rt_Array_Float_292_213:1.1126333, k_Lat_LQR_K_Matrics_rt_Array_Float_292_214:1.1166695, k_Lat_LQR_K_Matrics_rt_Array_Float_292_215:1.1201586, k_Lat_LQR_K_Matrics_rt_Array_Float_292_216:1.1232235, k_Lat_LQR_K_Matrics_rt_Array_Float_292_217:1.1259714, k_Lat_LQR_K_Matrics_rt_Array_Float_292_218:1.1284704, k_Lat_LQR_K_Matrics_rt_Array_Float_292_219:1.1307907, k_Lat_LQR_K_Matrics_rt_Array_Float_292_220:0.01218279, k_Lat_LQR_K_Matrics_rt_Array_Float_292_221:0.01218279, k_Lat_LQR_K_Matrics_rt_Array_Float_292_222:0.01218279, k_Lat_LQR_K_Matrics_rt_Array_Float_292_223:0.01218279, k_Lat_LQR_K_Matrics_rt_Array_Float_292_224:0.01218279, k_Lat_LQR_K_Matrics_rt_Array_Float_292_225:0.01218279, k_Lat_LQR_K_Matrics_rt_Array_Float_292_226:0.01218279, k_Lat_LQR_K_Matrics_rt_Array_Float_292_227:0.01218279, k_Lat_LQR_K_Matrics_rt_Array_Float_292_228:0.01563984, k_Lat_LQR_K_Matrics_rt_Array_Float_292_229:0.01913789, k_Lat_LQR_K_Matrics_rt_Array_Float_292_230:0.02240084, k_Lat_LQR_K_Matrics_rt_Array_Float_292_231:0.0252241, k_Lat_LQR_K_Matrics_rt_Array_Float_292_232:0.02737904, k_Lat_LQR_K_Matrics_rt_Array_Float_292_233:0.03205071, k_Lat_LQR_K_Matrics_rt_Array_Float_292_234:0.03680194, k_Lat_LQR_K_Matrics_rt_Array_Float_292_235:0.04156275, k_Lat_LQR_K_Matrics_rt_Array_Float_292_236:0.0462778, k_Lat_LQR_K_Matrics_rt_Array_Float_292_237:0.05090594, k_Lat_LQR_K_Matrics_rt_Array_Float_292_238:0.05541809, k_Lat_LQR_K_Matrics_rt_Array_Float_292_239:0.0597981, k_Lat_LQR_K_Matrics_rt_Array_Float_292_240:0.06403761, k_Lat_LQR_K_Matrics_rt_Array_Float_292_241:0.06581949, k_Lat_LQR_K_Matrics_rt_Array_Float_292_242:0.06757926, k_Lat_LQR_K_Matrics_rt_Array_Float_292_243:0.06931736, k_Lat_LQR_K_Matrics_rt_Array_Float_292_244:0.07103433, k_Lat_LQR_K_Matrics_rt_Array_Float_292_245:0.07273129, k_Lat_LQR_K_Matrics_rt_Array_Float_292_246:0.0744087, k_Lat_LQR_K_Matrics_rt_Array_Float_292_247:0.07606724, k_Lat_LQR_K_Matrics_rt_Array_Float_292_248:0.0777083, k_Lat_LQR_K_Matrics_rt_Array_Float_292_249:0.07933255, k_Lat_LQR_K_Matrics_rt_Array_Float_292_250:0.08094081, k_Lat_LQR_K_Matrics_rt_Array_Float_292_251:0.08100308, k_Lat_LQR_K_Matrics_rt_Array_Float_292_252:0.08091122, k_Lat_LQR_K_Matrics_rt_Array_Float_292_253:0.08063727, k_Lat_LQR_K_Matrics_rt_Array_Float_292_254:0.08014419, k_Lat_LQR_K_Matrics_rt_Array_Float_292_255:0.07938046, k_Lat_LQR_K_Matrics_rt_Array_Float_292_256:0.07827576, k_Lat_LQR_K_Matrics_rt_Array_Float_292_257:0.07672662, k_Lat_LQR_K_Matrics_rt_Array_Float_292_258:0.07457751, k_Lat_LQR_K_Matrics_rt_Array_Float_292_259:0.07158098, k_Lat_LQR_K_Matrics_rt_Array_Float_292_260:0.06731817, k_Lat_LQR_K_Matrics_rt_Array_Float_292_261:0.06881698, k_Lat_LQR_K_Matrics_rt_Array_Float_292_262:0.0703058, k_Lat_LQR_K_Matrics_rt_Array_Float_292_263:0.07178555, k_Lat_LQR_K_Matrics_rt_Array_Float_292_264:0.07325662, k_Lat_LQR_K_Matrics_rt_Array_Float_292_265:0.07471798, k_Lat_LQR_K_Matrics_rt_Array_Float_292_266:0.07617093, k_Lat_LQR_K_Matrics_rt_Array_Float_292_267:0.07761536, k_Lat_LQR_K_Matrics_rt_Array_Float_292_268:0.07905097, k_Lat_LQR_K_Matrics_rt_Array_Float_292_269:0.08047893, k_Lat_LQR_K_Matrics_rt_Array_Float_292_270:0.08189865, k_Lat_LQR_K_Matrics_rt_Array_Float_292_271:0.08305865, k_Lat_LQR_K_Matrics_rt_Array_Float_292_272:0.08421065, k_Lat_LQR_K_Matrics_rt_Array_Float_292_273:0.0853555, k_Lat_LQR_K_Matrics_rt_Array_Float_292_274:0.08649262, k_Lat_LQR_K_Matrics_rt_Array_Float_292_275:0.08762167, k_Lat_LQR_K_Matrics_rt_Array_Float_292_276:0.08874382, k_Lat_LQR_K_Matrics_rt_Array_Float_292_277:0.08985866, k_Lat_LQR_K_Matrics_rt_Array_Float_292_278:0.09096621, k_Lat_LQR_K_Matrics_rt_Array_Float_292_279:0.09206648, k_Lat_LQR_K_Matrics_rt_Array_Float_292_280:0.09315908, k_Lat_LQR_K_Matrics_rt_Array_Float_292_281:0.1041731, k_Lat_LQR_K_Matrics_rt_Array_Float_292_282:0.1140875, k_Lat_LQR_K_Matrics_rt_Array_Float_292_283:0.1234904, k_Lat_LQR_K_Matrics_rt_Array_Float_292_284:0.1324099, k_Lat_LQR_K_Matrics_rt_Array_Float_292_285:0.1408733, k_Lat_LQR_K_Matrics_rt_Array_Float_292_286:0.148906, k_Lat_LQR_K_Matrics_rt_Array_Float_292_287:0.1565323, k_Lat_LQR_K_Matrics_rt_Array_Float_292_288:0.163776, k_Lat_LQR_K_Matrics_rt_Array_Float_292_289:0.1706612, k_Lat_LQR_K_Matrics_rt_Array_Float_292_290:0.1772103, k_Lat_LQR_K_Matrics_rt_Array_Float_292_291:0.183446, k_Lat_LQR_K_Matrics_rt_Array_Float_292_292:0.1893888]
    k_Lat_LQR_LatError_Weights: value-spec=k_Lat_LQR_LatError_Weights:[k_Lat_LQR_LatError_Weights_rt_Array_Float_22_1:0.2, k_Lat_LQR_LatError_Weights_rt_Array_Float_22_2:0.2, k_Lat_LQR_LatError_Weights_rt_Array_Float_22_3:0.2, k_Lat_LQR_LatError_Weights_rt_Array_Float_22_4:0.1, k_Lat_LQR_LatError_Weights_rt_Array_Float_22_5:0.1, k_Lat_LQR_LatError_Weights_rt_Array_Float_22_6:0.1, k_Lat_LQR_LatError_Weights_rt_Array_Float_22_7:0.1, k_Lat_LQR_LatError_Weights_rt_Array_Float_22_8:0.02, k_Lat_LQR_LatError_Weights_rt_Array_Float_22_9:0.02, k_Lat_LQR_LatError_Weights_rt_Array_Float_22_10:0.02, k_Lat_LQR_LatError_Weights_rt_Array_Float_22_11:0.015, k_Lat_LQR_LatError_Weights_rt_Array_Float_22_12:0.015, k_Lat_LQR_LatError_Weights_rt_Array_Float_22_13:0.015, k_Lat_LQR_LatError_Weights_rt_Array_Float_22_14:0.015, k_Lat_LQR_LatError_Weights_rt_Array_Float_22_15:0.015, k_Lat_LQR_LatError_Weights_rt_Array_Float_22_16:0.015, k_Lat_LQR_LatError_Weights_rt_Array_Float_22_17:0.015, k_Lat_LQR_LatError_Weights_rt_Array_Float_22_18:0.015, k_Lat_LQR_LatError_Weights_rt_Array_Float_22_19:0.015, k_Lat_LQR_LatError_Weights_rt_Array_Float_22_20:0.015, k_Lat_LQR_LatError_Weights_rt_Array_Float_22_21:0.015, k_Lat_LQR_LatError_Weights_rt_Array_Float_22_22:0.015]
    k_Lat_ManualCmd: value-spec=k_Lat_ManualCmd:0
    k_Lat_MaxLatAcc: value-spec=k_Lat_MaxLatAcc:5
    k_Lat_MaxStrWhlAng: value-spec=k_Lat_MaxStrWhlAng:[k_Lat_MaxStrWhlAng_rt_Array_Float_22_1:1600, k_Lat_MaxStrWhlAng_rt_Array_Float_22_2:1600, k_Lat_MaxStrWhlAng_rt_Array_Float_22_3:1600, k_Lat_MaxStrWhlAng_rt_Array_Float_22_4:1600, k_Lat_MaxStrWhlAng_rt_Array_Float_22_5:1600, k_Lat_MaxStrWhlAng_rt_Array_Float_22_6:1600, k_Lat_MaxStrWhlAng_rt_Array_Float_22_7:1600, k_Lat_MaxStrWhlAng_rt_Array_Float_22_8:1600, k_Lat_MaxStrWhlAng_rt_Array_Float_22_9:1600, k_Lat_MaxStrWhlAng_rt_Array_Float_22_10:1400, k_Lat_MaxStrWhlAng_rt_Array_Float_22_11:1400, k_Lat_MaxStrWhlAng_rt_Array_Float_22_12:1400, k_Lat_MaxStrWhlAng_rt_Array_Float_22_13:1400, k_Lat_MaxStrWhlAng_rt_Array_Float_22_14:1000, k_Lat_MaxStrWhlAng_rt_Array_Float_22_15:800, k_Lat_MaxStrWhlAng_rt_Array_Float_22_16:800, k_Lat_MaxStrWhlAng_rt_Array_Float_22_17:600, k_Lat_MaxStrWhlAng_rt_Array_Float_22_18:400, k_Lat_MaxStrWhlAng_rt_Array_Float_22_19:400, k_Lat_MaxStrWhlAng_rt_Array_Float_22_20:300, k_Lat_MaxStrWhlAng_rt_Array_Float_22_21:300, k_Lat_MaxStrWhlAng_rt_Array_Float_22_22:300]
    k_Lat_PPMinDist: value-spec=k_Lat_PPMinDist:5
    k_Lat_PP_PrvTi: value-spec=k_Lat_PP_PrvTi:0.5
    k_Lat_SteerAngloffset: value-spec=k_Lat_SteerAngloffset:-25
    k_Lat_UWeight: value-spec=k_Lat_UWeight:1
    k_Lat_feedforwardhidingindex: value-spec=k_Lat_feedforwardhidingindex:[k_Lat_feedforwardhidingindex_rt_Array_Float_25_1:0, k_Lat_feedforwardhidingindex_rt_Array_Float_25_2:0, k_Lat_feedforwardhidingindex_rt_Array_Float_25_3:0, k_Lat_feedforwardhidingindex_rt_Array_Float_25_4:0, k_Lat_feedforwardhidingindex_rt_Array_Float_25_5:0, k_Lat_feedforwardhidingindex_rt_Array_Float_25_6:0, k_Lat_feedforwardhidingindex_rt_Array_Float_25_7:0, k_Lat_feedforwardhidingindex_rt_Array_Float_25_8:0, k_Lat_feedforwardhidingindex_rt_Array_Float_25_9:0, k_Lat_feedforwardhidingindex_rt_Array_Float_25_10:0, k_Lat_feedforwardhidingindex_rt_Array_Float_25_11:0, k_Lat_feedforwardhidingindex_rt_Array_Float_25_12:0, k_Lat_feedforwardhidingindex_rt_Array_Float_25_13:0, k_Lat_feedforwardhidingindex_rt_Array_Float_25_14:0, k_Lat_feedforwardhidingindex_rt_Array_Float_25_15:0, k_Lat_feedforwardhidingindex_rt_Array_Float_25_16:0, k_Lat_feedforwardhidingindex_rt_Array_Float_25_17:0, k_Lat_feedforwardhidingindex_rt_Array_Float_25_18:0, k_Lat_feedforwardhidingindex_rt_Array_Float_25_19:0, k_Lat_feedforwardhidingindex_rt_Array_Float_25_20:0, k_Lat_feedforwardhidingindex_rt_Array_Float_25_21:0, k_Lat_feedforwardhidingindex_rt_Array_Float_25_22:0, k_Lat_feedforwardhidingindex_rt_Array_Float_25_23:0, k_Lat_feedforwardhidingindex_rt_Array_Float_25_24:0, k_Lat_feedforwardhidingindex_rt_Array_Float_25_25:0]
    k_Lat_feedforwardindex: value-spec=k_Lat_feedforwardindex:[k_Lat_feedforwardindex_rt_Array_Float_25_1:1, k_Lat_feedforwardindex_rt_Array_Float_25_2:1, k_Lat_feedforwardindex_rt_Array_Float_25_3:1, k_Lat_feedforwardindex_rt_Array_Float_25_4:1, k_Lat_feedforwardindex_rt_Array_Float_25_5:1, k_Lat_feedforwardindex_rt_Array_Float_25_6:1, k_Lat_feedforwardindex_rt_Array_Float_25_7:1, k_Lat_feedforwardindex_rt_Array_Float_25_8:1, k_Lat_feedforwardindex_rt_Array_Float_25_9:1, k_Lat_feedforwardindex_rt_Array_Float_25_10:1.1, k_Lat_feedforwardindex_rt_Array_Float_25_11:1.1, k_Lat_feedforwardindex_rt_Array_Float_25_12:1.1, k_Lat_feedforwardindex_rt_Array_Float_25_13:1.1, k_Lat_feedforwardindex_rt_Array_Float_25_14:1.1, k_Lat_feedforwardindex_rt_Array_Float_25_15:1.1, k_Lat_feedforwardindex_rt_Array_Float_25_16:1.1, k_Lat_feedforwardindex_rt_Array_Float_25_17:1.1, k_Lat_feedforwardindex_rt_Array_Float_25_18:1.1, k_Lat_feedforwardindex_rt_Array_Float_25_19:1, k_Lat_feedforwardindex_rt_Array_Float_25_20:1.05, k_Lat_feedforwardindex_rt_Array_Float_25_21:1.05, k_Lat_feedforwardindex_rt_Array_Float_25_22:1.05, k_Lat_feedforwardindex_rt_Array_Float_25_23:1.05, k_Lat_feedforwardindex_rt_Array_Float_25_24:1.05, k_Lat_feedforwardindex_rt_Array_Float_25_25:1.05]
    k_Lat_lqrtolerance: value-spec=k_Lat_lqrtolerance:0.01
    k_Lat_maxiteration: value-spec=k_Lat_maxiteration:150
    k_Lat_steerratioindex: value-spec=k_Lat_steerratioindex:1
    k_LongCtrl_DistCtrl_I_LowLmt: value-spec=k_LongCtrl_DistCtrl_I_LowLmt:-1
    k_LongCtrl_DistCtrl_I_UppLmt: value-spec=k_LongCtrl_DistCtrl_I_UppLmt:1
    k_LongCtrl_DistCtrl_LowLmt: value-spec=k_LongCtrl_DistCtrl_LowLmt:-1
    k_LongCtrl_DistCtrl_P_LowLmt: value-spec=k_LongCtrl_DistCtrl_P_LowLmt:-2
    k_LongCtrl_DistCtrl_P_UppLmt: value-spec=k_LongCtrl_DistCtrl_P_UppLmt:2
    k_LongCtrl_DistCtrl_UppLmt: value-spec=k_LongCtrl_DistCtrl_UppLmt:1
    k_LongCtrl_DistErrLImit_sweep: value-spec=k_LongCtrl_DistErrLImit_sweep:2
    k_LongCtrl_Dist_P_term_filter_gain: value-spec=k_LongCtrl_Dist_P_term_filter_gain:0.9
    k_LongCtrl_Freeze_DeltaDistErr_UppLmt_sweep: value-spec=k_LongCtrl_Freeze_DeltaDistErr_UppLmt_sweep:0.2
    k_LongCtrl_Freeze_DistErr_UppLmt_sweep: value-spec=k_LongCtrl_Freeze_DistErr_UppLmt_sweep:2
    k_LongCtrl_I_term_for_Disterr_y_sweep: value-spec=k_LongCtrl_I_term_for_Disterr_y_sweep:[k_LongCtrl_I_term_for_Disterr_y_sweep_rt_Array_Float_7_1:0, k_LongCtrl_I_term_for_Disterr_y_sweep_rt_Array_Float_7_2:0, k_LongCtrl_I_term_for_Disterr_y_sweep_rt_Array_Float_7_3:0, k_LongCtrl_I_term_for_Disterr_y_sweep_rt_Array_Float_7_4:0, k_LongCtrl_I_term_for_Disterr_y_sweep_rt_Array_Float_7_5:0, k_LongCtrl_I_term_for_Disterr_y_sweep_rt_Array_Float_7_6:0, k_LongCtrl_I_term_for_Disterr_y_sweep_rt_Array_Float_7_7:0]
    k_LongCtrl_I_term_for_Disterr_y_sweep_reverse: value-spec=k_LongCtrl_I_term_for_Disterr_y_sweep_reverse:[k_LongCtrl_I_term_for_Disterr_y_sweep_reverse_rt_Array_Float_7_1:0.1, k_LongCtrl_I_term_for_Disterr_y_sweep_reverse_rt_Array_Float_7_2:0.1, k_LongCtrl_I_term_for_Disterr_y_sweep_reverse_rt_Array_Float_7_3:0.1, k_LongCtrl_I_term_for_Disterr_y_sweep_reverse_rt_Array_Float_7_4:0.1, k_LongCtrl_I_term_for_Disterr_y_sweep_reverse_rt_Array_Float_7_5:0.1, k_LongCtrl_I_term_for_Disterr_y_sweep_reverse_rt_Array_Float_7_6:0.1, k_LongCtrl_I_term_for_Disterr_y_sweep_reverse_rt_Array_Float_7_7:0.1]
    k_LongCtrl_LongAccelFiltParam: value-spec=k_LongCtrl_LongAccelFiltParam:0.01
    k_LongCtrl_P_Uturn: value-spec=k_LongCtrl_P_Uturn:0
    k_LongCtrl_P_term_for_Disterr_y_sweep: value-spec=k_LongCtrl_P_term_for_Disterr_y_sweep:[k_LongCtrl_P_term_for_Disterr_y_sweep_rt_Array_Float_7_1:0.6, k_LongCtrl_P_term_for_Disterr_y_sweep_rt_Array_Float_7_2:0.4, k_LongCtrl_P_term_for_Disterr_y_sweep_rt_Array_Float_7_3:0.2, k_LongCtrl_P_term_for_Disterr_y_sweep_rt_Array_Float_7_4:0.2, k_LongCtrl_P_term_for_Disterr_y_sweep_rt_Array_Float_7_5:0.2, k_LongCtrl_P_term_for_Disterr_y_sweep_rt_Array_Float_7_6:0.2, k_LongCtrl_P_term_for_Disterr_y_sweep_rt_Array_Float_7_7:0.2]
    k_LongCtrl_P_term_for_Disterr_y_sweep_reverse: value-spec=k_LongCtrl_P_term_for_Disterr_y_sweep_reverse:[k_LongCtrl_P_term_for_Disterr_y_sweep_reverse_rt_Array_Float_7_1:0.4, k_LongCtrl_P_term_for_Disterr_y_sweep_reverse_rt_Array_Float_7_2:0.4, k_LongCtrl_P_term_for_Disterr_y_sweep_reverse_rt_Array_Float_7_3:0.4, k_LongCtrl_P_term_for_Disterr_y_sweep_reverse_rt_Array_Float_7_4:0.4, k_LongCtrl_P_term_for_Disterr_y_sweep_reverse_rt_Array_Float_7_5:0.4, k_LongCtrl_P_term_for_Disterr_y_sweep_reverse_rt_Array_Float_7_6:0.4, k_LongCtrl_P_term_for_Disterr_y_sweep_reverse_rt_Array_Float_7_7:0.4]
    k_LongCtrl_PitchAnglFiltParam: value-spec=k_LongCtrl_PitchAnglFiltParam:0.01
    k_LongCtrl_RoadGrdAccel: value-spec=k_LongCtrl_RoadGrdAccel:0
    k_LongCtrl_accel_limit_max_for_sweep_y: value-spec=k_LongCtrl_accel_limit_max_for_sweep_y:[k_LongCtrl_accel_limit_max_for_sweep_y_rt_Array_Float_5_1:1.1, k_LongCtrl_accel_limit_max_for_sweep_y_rt_Array_Float_5_2:1, k_LongCtrl_accel_limit_max_for_sweep_y_rt_Array_Float_5_3:0.9, k_LongCtrl_accel_limit_max_for_sweep_y_rt_Array_Float_5_4:0.8, k_LongCtrl_accel_limit_max_for_sweep_y_rt_Array_Float_5_5:0.7]
    k_LongCtrl_accel_limit_min_for_sweep_y: value-spec=k_LongCtrl_accel_limit_min_for_sweep_y:[k_LongCtrl_accel_limit_min_for_sweep_y_rt_Array_Float_2_1:-5, k_LongCtrl_accel_limit_min_for_sweep_y_rt_Array_Float_2_2:-3.5]
    k_LongCtrl_engine_Freeze_DeltaSpdErr_UppLmt_sweep: value-spec=k_LongCtrl_engine_Freeze_DeltaSpdErr_UppLmt_sweep:0.1
    k_LongCtrl_engine_Freeze_SpdErr_UppLmt: value-spec=k_LongCtrl_engine_Freeze_SpdErr_UppLmt:0.27777777777777779
    k_LongCtrl_engine_I_LowLmt: value-spec=k_LongCtrl_engine_I_LowLmt:-0.75
    k_LongCtrl_engine_I_UppLmt: value-spec=k_LongCtrl_engine_I_UppLmt:0.75
    k_LongCtrl_engine_I_term_for_spderr_y: value-spec=k_LongCtrl_engine_I_term_for_spderr_y:[k_LongCtrl_engine_I_term_for_spderr_y_rt_Array_Float_9_1:0, k_LongCtrl_engine_I_term_for_spderr_y_rt_Array_Float_9_2:0, k_LongCtrl_engine_I_term_for_spderr_y_rt_Array_Float_9_3:0, k_LongCtrl_engine_I_term_for_spderr_y_rt_Array_Float_9_4:0, k_LongCtrl_engine_I_term_for_spderr_y_rt_Array_Float_9_5:0, k_LongCtrl_engine_I_term_for_spderr_y_rt_Array_Float_9_6:0, k_LongCtrl_engine_I_term_for_spderr_y_rt_Array_Float_9_7:0, k_LongCtrl_engine_I_term_for_spderr_y_rt_Array_Float_9_8:0, k_LongCtrl_engine_I_term_for_spderr_y_rt_Array_Float_9_9:0]
    k_LongCtrl_engine_I_term_for_spderr_y_sweep_HighSpeed: value-spec=k_LongCtrl_engine_I_term_for_spderr_y_sweep_HighSpeed:[k_LongCtrl_engine_I_term_for_spderr_y_sweep_HighSpeed_rt_Array_Float_9_1:0.3, k_LongCtrl_engine_I_term_for_spderr_y_sweep_HighSpeed_rt_Array_Float_9_2:0.3, k_LongCtrl_engine_I_term_for_spderr_y_sweep_HighSpeed_rt_Array_Float_9_3:0.3, k_LongCtrl_engine_I_term_for_spderr_y_sweep_HighSpeed_rt_Array_Float_9_4:0.3, k_LongCtrl_engine_I_term_for_spderr_y_sweep_HighSpeed_rt_Array_Float_9_5:0.3, k_LongCtrl_engine_I_term_for_spderr_y_sweep_HighSpeed_rt_Array_Float_9_6:0.3, k_LongCtrl_engine_I_term_for_spderr_y_sweep_HighSpeed_rt_Array_Float_9_7:0.3, k_LongCtrl_engine_I_term_for_spderr_y_sweep_HighSpeed_rt_Array_Float_9_8:0.3, k_LongCtrl_engine_I_term_for_spderr_y_sweep_HighSpeed_rt_Array_Float_9_9:0.3]
    k_LongCtrl_engine_I_term_for_spderr_y_sweep_LowSpeed: value-spec=k_LongCtrl_engine_I_term_for_spderr_y_sweep_LowSpeed:[k_LongCtrl_engine_I_term_for_spderr_y_sweep_LowSpeed_rt_Array_Float_9_1:0.3, k_LongCtrl_engine_I_term_for_spderr_y_sweep_LowSpeed_rt_Array_Float_9_2:0.3, k_LongCtrl_engine_I_term_for_spderr_y_sweep_LowSpeed_rt_Array_Float_9_3:0.3, k_LongCtrl_engine_I_term_for_spderr_y_sweep_LowSpeed_rt_Array_Float_9_4:0.3, k_LongCtrl_engine_I_term_for_spderr_y_sweep_LowSpeed_rt_Array_Float_9_5:0.3, k_LongCtrl_engine_I_term_for_spderr_y_sweep_LowSpeed_rt_Array_Float_9_6:0.3, k_LongCtrl_engine_I_term_for_spderr_y_sweep_LowSpeed_rt_Array_Float_9_7:0.3, k_LongCtrl_engine_I_term_for_spderr_y_sweep_LowSpeed_rt_Array_Float_9_8:0.3, k_LongCtrl_engine_I_term_for_spderr_y_sweep_LowSpeed_rt_Array_Float_9_9:0.3]
    k_LongCtrl_engine_I_term_for_spderr_y_sweep_Reverse: value-spec=k_LongCtrl_engine_I_term_for_spderr_y_sweep_Reverse:[k_LongCtrl_engine_I_term_for_spderr_y_sweep_Reverse_rt_Array_Float_9_1:0.3, k_LongCtrl_engine_I_term_for_spderr_y_sweep_Reverse_rt_Array_Float_9_2:0.3, k_LongCtrl_engine_I_term_for_spderr_y_sweep_Reverse_rt_Array_Float_9_3:0.3, k_LongCtrl_engine_I_term_for_spderr_y_sweep_Reverse_rt_Array_Float_9_4:0.3, k_LongCtrl_engine_I_term_for_spderr_y_sweep_Reverse_rt_Array_Float_9_5:0.3, k_LongCtrl_engine_I_term_for_spderr_y_sweep_Reverse_rt_Array_Float_9_6:0.3, k_LongCtrl_engine_I_term_for_spderr_y_sweep_Reverse_rt_Array_Float_9_7:0.3, k_LongCtrl_engine_I_term_for_spderr_y_sweep_Reverse_rt_Array_Float_9_8:0.3, k_LongCtrl_engine_I_term_for_spderr_y_sweep_Reverse_rt_Array_Float_9_9:0.3]
    k_LongCtrl_engine_LowLmt: value-spec=k_LongCtrl_engine_LowLmt:-3
    k_LongCtrl_engine_P_LowLmt: value-spec=k_LongCtrl_engine_P_LowLmt:-1
    k_LongCtrl_engine_P_UppLmt: value-spec=k_LongCtrl_engine_P_UppLmt:1
    k_LongCtrl_engine_P_term_filter_gain: value-spec=k_LongCtrl_engine_P_term_filter_gain:0.9
    k_LongCtrl_engine_P_term_for_spderr_y: value-spec=k_LongCtrl_engine_P_term_for_spderr_y:[k_LongCtrl_engine_P_term_for_spderr_y_rt_Array_Float_9_1:0.2, k_LongCtrl_engine_P_term_for_spderr_y_rt_Array_Float_9_2:0.2, k_LongCtrl_engine_P_term_for_spderr_y_rt_Array_Float_9_3:0.2, k_LongCtrl_engine_P_term_for_spderr_y_rt_Array_Float_9_4:0.2, k_LongCtrl_engine_P_term_for_spderr_y_rt_Array_Float_9_5:0.2, k_LongCtrl_engine_P_term_for_spderr_y_rt_Array_Float_9_6:0.2, k_LongCtrl_engine_P_term_for_spderr_y_rt_Array_Float_9_7:0.2, k_LongCtrl_engine_P_term_for_spderr_y_rt_Array_Float_9_8:0.2, k_LongCtrl_engine_P_term_for_spderr_y_rt_Array_Float_9_9:0.2]
    k_LongCtrl_engine_P_term_for_spderr_y_sweep_HighSpeed: value-spec=k_LongCtrl_engine_P_term_for_spderr_y_sweep_HighSpeed:[k_LongCtrl_engine_P_term_for_spderr_y_sweep_HighSpeed_rt_Array_Float_9_1:0.8, k_LongCtrl_engine_P_term_for_spderr_y_sweep_HighSpeed_rt_Array_Float_9_2:0.8, k_LongCtrl_engine_P_term_for_spderr_y_sweep_HighSpeed_rt_Array_Float_9_3:0.8, k_LongCtrl_engine_P_term_for_spderr_y_sweep_HighSpeed_rt_Array_Float_9_4:0.8, k_LongCtrl_engine_P_term_for_spderr_y_sweep_HighSpeed_rt_Array_Float_9_5:0.8, k_LongCtrl_engine_P_term_for_spderr_y_sweep_HighSpeed_rt_Array_Float_9_6:0.8, k_LongCtrl_engine_P_term_for_spderr_y_sweep_HighSpeed_rt_Array_Float_9_7:0.8, k_LongCtrl_engine_P_term_for_spderr_y_sweep_HighSpeed_rt_Array_Float_9_8:0.8, k_LongCtrl_engine_P_term_for_spderr_y_sweep_HighSpeed_rt_Array_Float_9_9:0.8]
    k_LongCtrl_engine_P_term_for_spderr_y_sweep_Reverse: value-spec=k_LongCtrl_engine_P_term_for_spderr_y_sweep_Reverse:[k_LongCtrl_engine_P_term_for_spderr_y_sweep_Reverse_rt_Array_Float_9_1:2, k_LongCtrl_engine_P_term_for_spderr_y_sweep_Reverse_rt_Array_Float_9_2:2, k_LongCtrl_engine_P_term_for_spderr_y_sweep_Reverse_rt_Array_Float_9_3:2, k_LongCtrl_engine_P_term_for_spderr_y_sweep_Reverse_rt_Array_Float_9_4:2, k_LongCtrl_engine_P_term_for_spderr_y_sweep_Reverse_rt_Array_Float_9_5:2, k_LongCtrl_engine_P_term_for_spderr_y_sweep_Reverse_rt_Array_Float_9_6:2, k_LongCtrl_engine_P_term_for_spderr_y_sweep_Reverse_rt_Array_Float_9_7:2, k_LongCtrl_engine_P_term_for_spderr_y_sweep_Reverse_rt_Array_Float_9_8:2, k_LongCtrl_engine_P_term_for_spderr_y_sweep_Reverse_rt_Array_Float_9_9:2]
    k_LongCtrl_engine_P_term_for_spderr_y_sweep_lowSpeed: value-spec=k_LongCtrl_engine_P_term_for_spderr_y_sweep_lowSpeed:[k_LongCtrl_engine_P_term_for_spderr_y_sweep_lowSpeed_rt_Array_Float_9_1:0.9, k_LongCtrl_engine_P_term_for_spderr_y_sweep_lowSpeed_rt_Array_Float_9_2:0.9, k_LongCtrl_engine_P_term_for_spderr_y_sweep_lowSpeed_rt_Array_Float_9_3:0.9, k_LongCtrl_engine_P_term_for_spderr_y_sweep_lowSpeed_rt_Array_Float_9_4:0.9, k_LongCtrl_engine_P_term_for_spderr_y_sweep_lowSpeed_rt_Array_Float_9_5:0.9, k_LongCtrl_engine_P_term_for_spderr_y_sweep_lowSpeed_rt_Array_Float_9_6:0.9, k_LongCtrl_engine_P_term_for_spderr_y_sweep_lowSpeed_rt_Array_Float_9_7:0.9, k_LongCtrl_engine_P_term_for_spderr_y_sweep_lowSpeed_rt_Array_Float_9_8:0.9, k_LongCtrl_engine_P_term_for_spderr_y_sweep_lowSpeed_rt_Array_Float_9_9:0.9]
    k_LongCtrl_engine_UppLmt: value-spec=k_LongCtrl_engine_UppLmt:3
    k_LongCtrl_engine_accel_filter_gain: value-spec=k_LongCtrl_engine_accel_filter_gain:0.9
    k_LongCtrl_jerk_limit_max_for_sweep_y: value-spec=k_LongCtrl_jerk_limit_max_for_sweep_y:[k_LongCtrl_jerk_limit_max_for_sweep_y_rt_Array_Float_5_1:1, k_LongCtrl_jerk_limit_max_for_sweep_y_rt_Array_Float_5_2:0.5, k_LongCtrl_jerk_limit_max_for_sweep_y_rt_Array_Float_5_3:0.125, k_LongCtrl_jerk_limit_max_for_sweep_y_rt_Array_Float_5_4:0.125, k_LongCtrl_jerk_limit_max_for_sweep_y_rt_Array_Float_5_5:0.125]
    k_LongCtrl_jerk_limit_min_for_sweep_y: value-spec=k_LongCtrl_jerk_limit_min_for_sweep_y:[k_LongCtrl_jerk_limit_min_for_sweep_y_rt_Array_Float_5_1:-1.5, k_LongCtrl_jerk_limit_min_for_sweep_y_rt_Array_Float_5_2:-1.2, k_LongCtrl_jerk_limit_min_for_sweep_y_rt_Array_Float_5_3:-0.8, k_LongCtrl_jerk_limit_min_for_sweep_y_rt_Array_Float_5_4:-0.6, k_LongCtrl_jerk_limit_min_for_sweep_y_rt_Array_Float_5_5:-0.6]
    k_LongCtrl_sweep_jerk_limit_max_for_brake_y: value-spec=k_LongCtrl_sweep_jerk_limit_max_for_brake_y:[k_LongCtrl_sweep_jerk_limit_max_for_brake_y_rt_Array_Float_5_1:2.5, k_LongCtrl_sweep_jerk_limit_max_for_brake_y_rt_Array_Float_5_2:2.5, k_LongCtrl_sweep_jerk_limit_max_for_brake_y_rt_Array_Float_5_3:2.5, k_LongCtrl_sweep_jerk_limit_max_for_brake_y_rt_Array_Float_5_4:2.5, k_LongCtrl_sweep_jerk_limit_max_for_brake_y_rt_Array_Float_5_5:2.5]
    k_LongCtrl_sweep_jerk_limit_max_for_engine_y: value-spec=k_LongCtrl_sweep_jerk_limit_max_for_engine_y:[k_LongCtrl_sweep_jerk_limit_max_for_engine_y_rt_Array_Float_5_1:2, k_LongCtrl_sweep_jerk_limit_max_for_engine_y_rt_Array_Float_5_2:2, k_LongCtrl_sweep_jerk_limit_max_for_engine_y_rt_Array_Float_5_3:1.6, k_LongCtrl_sweep_jerk_limit_max_for_engine_y_rt_Array_Float_5_4:1.6, k_LongCtrl_sweep_jerk_limit_max_for_engine_y_rt_Array_Float_5_5:1.6]
    k_LongCtrl_sweep_jerk_limit_min_for_brake_y: value-spec=k_LongCtrl_sweep_jerk_limit_min_for_brake_y:[k_LongCtrl_sweep_jerk_limit_min_for_brake_y_rt_Array_Float_5_1:-2, k_LongCtrl_sweep_jerk_limit_min_for_brake_y_rt_Array_Float_5_2:-2, k_LongCtrl_sweep_jerk_limit_min_for_brake_y_rt_Array_Float_5_3:-1.6, k_LongCtrl_sweep_jerk_limit_min_for_brake_y_rt_Array_Float_5_4:-1.6, k_LongCtrl_sweep_jerk_limit_min_for_brake_y_rt_Array_Float_5_5:-1.6]
    k_LongCtrl_sweep_jerk_limit_min_for_engine_y: value-spec=k_LongCtrl_sweep_jerk_limit_min_for_engine_y:[k_LongCtrl_sweep_jerk_limit_min_for_engine_y_rt_Array_Float_5_1:-2.5, k_LongCtrl_sweep_jerk_limit_min_for_engine_y_rt_Array_Float_5_2:-2.5, k_LongCtrl_sweep_jerk_limit_min_for_engine_y_rt_Array_Float_5_3:-2.5, k_LongCtrl_sweep_jerk_limit_min_for_engine_y_rt_Array_Float_5_4:-2.5, k_LongCtrl_sweep_jerk_limit_min_for_engine_y_rt_Array_Float_5_5:-2.5]
    k_SigMap_DragAcc: value-spec=k_SigMap_DragAcc:0.2
    k_SigMap_MotorRefTrq: value-spec=k_SigMap_MotorRefTrq:1500
    k_SigMap_SpdReducerRatio: value-spec=k_SigMap_SpdReducerRatio:5.571
    k_SigMap_WhlRadius: value-spec=k_SigMap_WhlRadius:0.507
    k_SigMap_torque_pid_conf_ki: value-spec=k_SigMap_torque_pid_conf_ki:[k_SigMap_torque_pid_conf_ki_rt_Array_Float_9_1:0.3, k_SigMap_torque_pid_conf_ki_rt_Array_Float_9_2:0.3, k_SigMap_torque_pid_conf_ki_rt_Array_Float_9_3:0.3, k_SigMap_torque_pid_conf_ki_rt_Array_Float_9_4:0.3, k_SigMap_torque_pid_conf_ki_rt_Array_Float_9_5:0.3, k_SigMap_torque_pid_conf_ki_rt_Array_Float_9_6:0.3, k_SigMap_torque_pid_conf_ki_rt_Array_Float_9_7:0.3, k_SigMap_torque_pid_conf_ki_rt_Array_Float_9_8:0.3, k_SigMap_torque_pid_conf_ki_rt_Array_Float_9_9:0.3]
    k_SigMap_torque_pid_conf_kp: value-spec=k_SigMap_torque_pid_conf_kp:[k_SigMap_torque_pid_conf_kp_rt_Array_Float_9_1:0.8, k_SigMap_torque_pid_conf_kp_rt_Array_Float_9_2:0.8, k_SigMap_torque_pid_conf_kp_rt_Array_Float_9_3:0.8, k_SigMap_torque_pid_conf_kp_rt_Array_Float_9_4:0.8, k_SigMap_torque_pid_conf_kp_rt_Array_Float_9_5:0.8, k_SigMap_torque_pid_conf_kp_rt_Array_Float_9_6:0.8, k_SigMap_torque_pid_conf_kp_rt_Array_Float_9_7:0.8, k_SigMap_torque_pid_conf_kp_rt_Array_Float_9_8:0.8, k_SigMap_torque_pid_conf_kp_rt_Array_Float_9_9:0.8]
    k_VSE_cf: value-spec=k_VSE_cf:212630
    k_VSE_cr: value-spec=k_VSE_cr:425260
    k_VSE_mass_rearleft: value-spec=k_VSE_mass_rearleft:2500
    k_VSE_mass_rearright: value-spec=k_VSE_mass_rearright:2500
    k_VSE_massfrontleft: value-spec=k_VSE_massfrontleft:2500
    k_VSE_massfrontright: value-spec=k_VSE_massfrontright:2500
    k_VSE_totalmass: value-spec=k_VSE_totalmass:10000
    k_VSE_wheelbase: value-spec=k_VSE_wheelbase:4.55
    k_Veh_FrontWhl2StrWhl_Ratio: value-spec=k_Veh_FrontWhl2StrWhl_Ratio:19.07
    k_lat_CrvtOffset: value-spec=k_lat_CrvtOffset:[k_lat_CrvtOffset_rt_Array_Float_8_1:1, k_lat_CrvtOffset_rt_Array_Float_8_2:1, k_lat_CrvtOffset_rt_Array_Float_8_3:1, k_lat_CrvtOffset_rt_Array_Float_8_4:1, k_lat_CrvtOffset_rt_Array_Float_8_5:1, k_lat_CrvtOffset_rt_Array_Float_8_6:1, k_lat_CrvtOffset_rt_Array_Float_8_7:1, k_lat_CrvtOffset_rt_Array_Float_8_8:1]
    k_ADM_LocTiThres: value-spec=k_ADM_LocTiThres:2000
    k_ADM_PlanTiThres: value-spec=k_ADM_PlanTiThres:2000
    k_CRM_CrvtUsingNearestPoint: value-spec=k_CRM_CrvtUsingNearestPoint:0
    k_CRM_UsingPositionNearest: value-spec=k_CRM_UsingPositionNearest:1
    k_CRM_UsingTrajPointCalc: value-spec=k_CRM_UsingTrajPointCalc:1
    k_EM_LocPosFarFromTrajErrSwt: value-spec=k_EM_LocPosFarFromTrajErrSwt:1
    k_Lat_LQR_Online: value-spec=k_Lat_LQR_Online:1
    k_Lat_LqrDuSwt: value-spec=k_Lat_LqrDuSwt:1
    k_Lat_ManualOption: value-spec=k_Lat_ManualOption:1
    k_Lat_PPForceSwt: value-spec=k_Lat_PPForceSwt:0
    k_Lat_PPSwt: value-spec=k_Lat_PPSwt:0
    k_Lat_SteerAngloffsetManual: value-spec=k_Lat_SteerAngloffsetManual:0
    k_Lat_isuturn: value-spec=k_Lat_isuturn:0
    k_LongCtrl_GrdAccelCompEnable: value-spec=k_LongCtrl_GrdAccelCompEnable:1
    k_ADM_ManualActvSwt: value-spec=k_ADM_ManualActvSwt:0
    k_ADM_SimActvSwt: value-spec=k_ADM_SimActvSwt:0
    k_CRM_Calibration_Enable: value-spec=k_CRM_Calibration_Enable:0
    k_LongCtrl_P_UturnSwt: value-spec=k_LongCtrl_P_UturnSwt:0
    k_SigMap_LatAccCmpSwt: value-spec=k_SigMap_LatAccCmpSwt:1
    k_SigMap_ManualTrqSwt: value-spec=k_SigMap_ManualTrqSwt:0
    k_SigMap_trq_PI_swt: value-spec=k_SigMap_trq_PI_swt:1
    k_VSE_SpdSource: value-spec=k_VSE_SpdSource:0
package /DataTypes/SwAddrMethods
  sw addr method CODE: section-type=CODE
  sw addr method CONST: section-type=CONST
  sw addr method VAR: section-type=VAR
package /DataTypes/Units
  unit NoUnit: factor-si-to-unit=1, offset-si-to-unit=0
